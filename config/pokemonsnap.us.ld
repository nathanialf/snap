SECTIONS
{
    __romPos = 0;
    header_ROM_START = __romPos;
    header_VRAM = ADDR(.header);
    .header : AT(header_ROM_START)
    {
        FILL(0x00000000);
        header_DATA_START = .;
        build/asm/header.o(.data);
        header_DATA_END = .;
        header_DATA_SIZE = ABSOLUTE(header_DATA_END - header_DATA_START);
    }
    __romPos += SIZEOF(.header);
    header_ROM_END = __romPos;
    header_VRAM_END = .;

    boot_ROM_START = __romPos;
    boot_VRAM = ADDR(.boot);
    .boot : AT(boot_ROM_START)
    {
        FILL(0x00000000);
        boot_DATA_START = .;
        build/assets/boot.o(.data);
        boot_DATA_END = .;
        boot_DATA_SIZE = ABSOLUTE(boot_DATA_END - boot_DATA_START);
    }
    __romPos += SIZEOF(.boot);
    boot_ROM_END = __romPos;
    boot_VRAM_END = .;

    main_ROM_START = __romPos;
    main_VRAM = ADDR(.main);
    .main 0x80100400 : AT(main_ROM_START)
    {
        FILL(0x00000000);
        main_TEXT_START = .;
        build/asm/1000.o(.text);
        build/src/func_8010046C.o(.text);
        build/src/boot_hw_probe.o(.text);
        build/src/func_801004E0.o(.text);
        build/asm/1110.o(.text);
        build/src/func_80100920.o(.text);
        build/asm/1528.o(.text);
        build/src/func_801009A0.o(.text);
        build/src/func_80100A08.o(.text);
        build/asm/1664.o(.text);
        build/src/func_80100C74.o(.text);
        build/asm/1ABC.o(.text);
        build/src/func_80101810.o(.text);
        build/asm/2498.o(.text);
        build/src/func_801024E4.o(.text);
        build/asm/3110.o(.text);
        build/src/func_80102954.o(.text);
        build/src/func_801029BC.o(.text);
        build/asm/3610.o(.text);
        build/src/func_80102C20.o(.text);
        build/asm/3894.o(.text);
        build/src/func_8010345C.o(.text);
        build/asm/4130.o(.text);
        build/asm/4680.o(.text);
        build/src/func_801047D4.o(.text);
        build/src/func_80104838.o(.text);
        build/asm/5510.o(.text);
        build/src/func_801049C4.o(.text);
        build/asm/5624.o(.text);
        build/src/func_80104AF8.o(.text);
        build/asm/5770.o(.text);
        build/src/func_80104D94.o(.text);
        build/src/func_80104DE8.o(.text);
        build/src/func_80104E7C.o(.text);
        build/src/func_80104EA4.o(.text);
        build/asm/5B24.o(.text);
        build/src/func_801053F0.o(.text);
        build/src/func_80105418.o(.text);
        build/asm/60D0.o(.text);
        build/asm/637C.o(.text);
        build/src/func_801067EC.o(.text);
        build/src/func_80106804.o(.text);
        build/src/func_80106878.o(.text);
        build/asm/7508.o(.text);
        build/src/func_80106E24.o(.text);
        build/src/func_80106E5C.o(.text);
        build/src/func_80106EC0.o(.text);
        build/src/func_80106F10.o(.text);
        build/asm/7B8C.o(.text);
        build/src/func_80107354.o(.text);
        build/asm/7FAC.o(.text);
        build/src/func_801075FC.o(.text);
        build/asm/82F0.o(.text);
        build/src/func_80107850.o(.text);
        build/asm/845C.o(.text);
        build/src/func_801078C4.o(.text);
        build/asm/8510.o(.text);
        build/src/func_801079B8.o(.text);
        build/src/func_80107A04.o(.text);
        build/asm/8814.o(.text);
        build/asm/8820.o(.text);
        build/src/func_80107CBC.o(.text);
        build/asm/8914.o(.text);
        build/src/func_80107E80.o(.text);
        build/src/func_80107EF8.o(.text);
        build/src/func_80107F24.o(.text);
        build/src/func_80108000.o(.text);
        build/src/func_80108024.o(.text);
        build/src/func_801080A0.o(.text);
        build/asm/8D18.o(.text);
        build/src/func_801081F0.o(.text);
        build/src/func_8010821C.o(.text);
        build/src/func_801082D8.o(.text);
        build/src/func_80108360.o(.text);
        build/asm/8F94.o(.text);
        build/src/func_80108460.o(.text);
        build/src/func_8010848C.o(.text);
        build/src/func_801084F4.o(.text);
        build/src/func_80108560.o(.text);
        build/src/func_801086B8.o(.text);
        build/src/func_80108724.o(.text);
        build/src/func_80108814.o(.text);
        build/src/func_8010888C.o(.text);
        build/src/func_801088B8.o(.text);
        build/src/func_80108930.o(.text);
        build/src/func_8010898C.o(.text);
        build/src/func_80108A04.o(.text);
        build/asm/9828.o(.text);
        build/src/func_80109760.o(.text);
        build/asm/A390.o(.text);
        build/src/func_80109918.o(.text);
        build/src/func_80109B1C.o(.text);
        build/asm/A77C.o(.text);
        build/src/func_80109C94.o(.text);
        build/asm/A90C.o(.text);
        build/src/func_80109E20.o(.text);
        build/asm/AA94.o(.text);
        build/src/func_8010A410.o(.text);
        build/src/func_8010A490.o(.text);
        build/src/func_8010A52C.o(.text);
        build/asm/B1F8.o(.text);
        build/src/func_8010A740.o(.text);
        build/src/func_8010A828.o(.text);
        build/src/func_8010A8A4.o(.text);
        build/src/func_8010A92C.o(.text);
        build/src/func_8010A9D8.o(.text);
        build/src/func_8010AA0C.o(.text);
        build/src/func_8010AA84.o(.text);
        build/src/func_8010AAD8.o(.text);
        build/src/func_8010AB30.o(.text);
        build/src/func_8010ABAC.o(.text);
        build/src/func_8010AC28.o(.text);
        build/src/func_8010ACAC.o(.text);
        build/src/func_8010AD14.o(.text);
        build/src/func_8010AD88.o(.text);
        build/asm/B9A0.o(.text);
        build/src/func_8010AE4C.o(.text);
        build/asm/BAC4.o(.text);
        build/src/func_8010B6F0.o(.text);
        build/src/func_8010B740.o(.text);
        build/src/func_8010B774.o(.text);
        build/src/func_8010B808.o(.text);
        build/src/func_8010B830.o(.text);
        build/asm/C480.o(.text);
        build/src/func_8010B998.o(.text);
        build/asm/C5B0.o(.text);
        build/src/func_8010BC2C.o(.text);
        build/asm/C8A8.o(.text);
        build/src/func_8010BD44.o(.text);
        build/src/func_8010BDDC.o(.text);
        build/src/func_8010BE5C.o(.text);
        build/src/func_8010BEAC.o(.text);
        build/asm/CCD8.o(.text);
        build/src/func_8010C1CC.o(.text);
        build/src/func_8010C220.o(.text);
        build/asm/CE74.o(.text);
        build/asm/D150.o(.text);
        build/src/func_8010C5B4.o(.text);
        build/src/func_8010C6C0.o(.text);
        build/src/func_8010C704.o(.text);
        build/src/func_8010C7CC.o(.text);
        build/asm/D43C.o(.text);
        build/src/func_8010FAFC.o(.text);
        build/src/func_8010FB34.o(.text);
        build/asm/107C4.o(.text);
        build/src/func_8011054C.o(.text);
        build/asm/11184.o(.text);
        build/src/func_80111090.o(.text);
        build/asm/11CBC.o(.text);
        build/src/func_80111230.o(.text);
        build/asm/11E68.o(.text);
        build/src/func_80114D60.o(.text);
        build/asm/159F0.o(.text);
        build/src/func_80114F98.o(.text);
        build/asm/15BF0.o(.text);
        build/src/func_801153EC.o(.text);
        build/asm/16048.o(.text);
        build/src/func_80115890.o(.text);
        build/asm/164E8.o(.text);
        build/src/func_8011679C.o(.text);
        build/asm/173F4.o(.text);
        build/src/func_80116C88.o(.text);
        build/asm/178E0.o(.text);
        build/src/func_80117768.o(.text);
        build/asm/183D8.o(.text);
        build/src/func_80118CD0.o(.text);
        build/asm/198DC.o(.text);
        build/src/func_801191D8.o(.text);
        build/asm/19E78.o(.text);
        build/src/func_80119960.o(.text);
        build/asm/1A594.o(.text);
        build/src/func_80119CD0.o(.text);
        build/src/func_80119D48.o(.text);
        build/asm/1A960.o(.text);
        build/src/func_80119DB0.o(.text);
        build/asm/1AA78.o(.text);
        build/asm/1AF60.o(.text);
        build/src/vec3.o(.text);
        build/asm/1B130.o(.text);
        build/src/func_8011A88C.o(.text);
        build/asm/1B4B8.o(.text);
        build/src/func_8011AA40.o(.text);
        build/asm/1B688.o(.text);
        build/src/func_8011AF30.o(.text);
        build/asm/1BB80.o(.text);
        build/asm/1BCF0.o(.text);
        build/src/func_8011B7FC.o(.text);
        build/asm/1C470.o(.text);
        build/src/func_8011BB48.o(.text);
        build/asm/1C7C4.o(.text);
        build/src/func_8011BFAC.o(.text);
        build/asm/1CC24.o(.text);
        build/src/func_8011C664.o(.text);
        build/asm/1D2C8.o(.text);
        build/src/func_8011C8F4.o(.text);
        build/asm/1D54C.o(.text);
        build/src/func_8011CB14.o(.text);
        build/asm/1D76C.o(.text);
        build/src/func_8011D078.o(.text);
        build/src/func_8011D0C4.o(.text);
        build/src/func_8011D184.o(.text);
        build/src/func_8011D1F0.o(.text);
        build/asm/1DE6C.o(.text);
        build/src/func_8011D648.o(.text);
        build/asm/1E29C.o(.text);
        build/src/func_8011D9A4.o(.text);
        build/asm/1E608.o(.text);
        build/src/func_8011DF78.o(.text);
        build/src/func_8011DFCC.o(.text);
        build/asm/1ED00.o(.text);
        build/src/func_8011E1CC.o(.text);
        build/src/func_8011E20C.o(.text);
        build/src/func_8011E25C.o(.text);
        build/src/func_8011E2B0.o(.text);
        build/src/func_8011E37C.o(.text);
        build/src/func_8011E3BC.o(.text);
        build/src/func_8011E40C.o(.text);
        build/src/func_8011E460.o(.text);
        build/src/func_8011E4F0.o(.text);
        build/src/func_8011E528.o(.text);
        build/src/func_8011E574.o(.text);
        build/src/func_8011E5C0.o(.text);
        build/src/func_8011E650.o(.text);
        build/src/func_8011E688.o(.text);
        build/src/func_8011E6D4.o(.text);
        build/asm/1F320.o(.text);
        build/asm/1F960.o(.text);
        build/src/func_8011FCA4.o(.text);
        build/src/func_8011FCE8.o(.text);
        build/asm/2092C.o(.text);
        build/src/func_8011FD40.o(.text);
        build/asm/20974.o(.text);
        build/src/func_8011FDC8.o(.text);
        build/asm/20A08.o(.text);
        build/src/func_8011FFD8.o(.text);
        build/src/func_80120030.o(.text);
        build/asm/20C9C.o(.text);
        build/src/func_80120BAC.o(.text);
        build/src/func_80120BC4.o(.text);
        build/asm/21840.o(.text);
        build/src/func_801222D8.o(.text);
        build/src/func_80122300.o(.text);
        build/asm/22F74.o(.text);
        build/src/func_801226BC.o(.text);
        build/asm/2338C.o(.text);
        build/src/func_80122C0C.o(.text);
        build/asm/23828.o(.text);
        build/src/sound_chan_setMidi.o(.text);
        build/src/sound_chan_misc.o(.text);
        build/asm/23C74.o(.text);
        build/src/func_80123104.o(.text);
        build/asm/23D1C.o(.text);
        build/src/func_801239CC.o(.text);
        build/asm/245E0.o(.text);
        build/src/func_80124200.o(.text);
        build/asm/24E28.o(.text);
        build/src/func_80124F54.o(.text);
        build/asm/25B78.o(.text);
        build/src/func_80125918.o(.text);
        build/asm/26538.o(.text);
        build/src/func_80126140.o(.text);
        build/src/func_80126170.o(.text);
        build/asm/26DB8.o(.text);
        build/src/func_801287F0.o(.text);
        build/src/func_80128810.o(.text);
        build/src/func_80128830.o(.text);
        build/src/func_80128850.o(.text);
        build/src/func_801288C0.o(.text);
        build/src/func_8012891C.o(.text);
        build/src/func_80128930.o(.text);
        build/src/func_80128970.o(.text);
        build/asm/295C0.o(.text);
        build/asm/29610.o(.text);
        build/src/func_80129160.o(.text);
        build/asm/29D68.o(.text);
        build/src/func_80129C10.o(.text);
        build/asm/2A8D0.o(.text);
        build/asm/2A970.o(.text);
        build/asm/2ACC0.o(.text);
        build/asm/2AD70.o(.text);
        build/src/func_8012A390.o(.text);
        build/asm/2AFD0.o(.text);
        build/asm/2B060.o(.text);
        build/src/func_8012A4C0.o(.text);
        build/src/func_8012A500.o(.text);
        build/asm/2B120.o(.text);
        build/asm/2B1B0.o(.text);
        build/asm/2B240.o(.text);
        build/asm/2B2A0.o(.text);
        build/src/func_8012AB70.o(.text);
        build/asm/2B850.o(.text);
        build/src/func_8012AC9C.o(.text);
        build/asm/2B8C0.o(.text);
        build/asm/2B920.o(.text);
        build/src/func_8012B1E0.o(.text);
        build/src/func_8012B288.o(.text);
        build/src/func_8012B330.o(.text);
        build/src/func_8012B3BC.o(.text);
        build/asm/2C0A8.o(.text);
        build/asm/2C0B0.o(.text);
        build/src/func_8012B5D0.o(.text);
        build/asm/2C200.o(.text);
        build/src/func_8012B934.o(.text);
        build/asm/2C54C.o(.text);
        build/asm/2CE60.o(.text);
        build/src/func_8012C338.o(.text);
        build/asm/2CF70.o(.text);
        build/asm/2DBE0.o(.text);
        build/asm/2DED0.o(.text);
        build/src/func_8012DE50.o(.text);
        build/src/func_8012DE70.o(.text);
        build/asm/2EAB0.o(.text);
        build/asm/2EB10.o(.text);
        build/asm/2EBB0.o(.text);
        build/src/func_8012E03C.o(.text);
        build/asm/2ED28.o(.text);
        build/asm/2ED30.o(.text);
        build/src/func_8012FE34.o(.text);
        build/asm/30A6C.o(.text);
        build/asm/30C80.o(.text);
        build/src/func_801311F8.o(.text);
        build/asm/31E5C.o(.text);
        build/src/func_801312CC.o(.text);
        build/asm/31F3C.o(.text);
        build/src/func_801317E4.o(.text);
        build/asm/32440.o(.text);
        build/src/func_80131A54.o(.text);
        build/src/func_80131A90.o(.text);
        build/asm/326B0.o(.text);
        build/src/func_80131CFC.o(.text);
        build/asm/32960.o(.text);
        build/src/func_80131FC0.o(.text);
        build/asm/32BF8.o(.text);
        build/src/func_80132160.o(.text);
        build/asm/32D90.o(.text);
        build/src/func_801321F0.o(.text);
        build/src/func_80132240.o(.text);
        build/asm/32E60.o(.text);
        build/asm/32ED0.o(.text);
        build/src/func_80132400.o(.text);
        build/asm/33030.o(.text);
        build/src/func_80132440.o(.text);
        build/asm/33070.o(.text);
        build/asm/33110.o(.text);
        build/src/func_801325A0.o(.text);
        build/asm/331B0.o(.text);
        build/asm/33230.o(.text);
        build/asm/33380.o(.text);
        build/asm/33580.o(.text);
        build/src/func_80132E8C.o(.text);
        build/asm/33AD0.o(.text);
        build/src/ultra_libc_ll.o(.text);
        build/asm/33EA0.o(.text);
        build/asm/34880.o(.text);
        build/asm/34E30.o(.text);
        build/src/func_80134600.o(.text);
        build/asm/352C0.o(.text);
        build/asm/35600.o(.text);
        build/asm/35750.o(.text);
        build/src/ultra_os_virtualtophysical.o(.text);
        build/asm/359B0.o(.text);
        build/asm/35A30.o(.text);
        build/src/ultra_os_pirawread.o(.text);
        build/asm/35E50.o(.text);
        build/src/ultra_os_func_80135270.o(.text);
        build/asm/35EB0.o(.text);
        build/src/ultra_os_sprawdma.o(.text);
        build/asm/36160.o(.text);
        build/src/ultra_os_func_80135610.o(.text);
        build/src/ultra_os_func_80135660.o(.text);
        build/src/ultra_os_func_801356D0.o(.text);
        build/src/func_80135720.o(.text);
        build/src/ultra_os_func_80135740.o(.text);
        build/asm/363B0.o(.text);
        build/asm/36470.o(.text);
        build/src/func_801359E0.o(.text);
        build/asm/366A0.o(.text);
        build/src/ultra_os_func_80136020.o(.text);
        build/src/func_80136090.o(.text);
        build/src/ultra_os_func_801360A0.o(.text);
        build/src/func_80136124.o(.text);
        build/asm/36D4C.o(.text);
        build/src/func_80136150.o(.text);
        build/src/func_801361B0.o(.text);
        build/asm/36E10.o(.text);
        build/src/func_80136398.o(.text);
        build/asm/36FC8.o(.text);
        build/asm/37080.o(.text);
        build/asm/37290.o(.text);
        build/asm/37F50.o(.text);
        build/src/func_801374B0.o(.text);
        build/src/func_801374D4.o(.text);
        build/asm/38130.o(.text);
        build/asm/38180.o(.text);
        build/src/memcpy.o(.text);
        build/src/strlen.o(.text);
        build/src/func_801376B4.o(.text);
        build/src/ultra_os_createmesgqueue.o(.text);
        build/asm/38330.o(.text);
        build/asm/383B0.o(.text);
        build/src/ultra_os_sp_busy.o(.text);
        build/src/ultra_os_si_busy.o(.text);
        build/asm/384C0.o(.text);
        build/src/func_80137AF0.o(.text);
        build/asm/38708.o(.text);
        build/src/ultra_os_func_80137B10.o(.text);
        build/asm/38760.o(.text);
        build/src/ultra_os_gettime.o(.text);
        build/asm/38B70.o(.text);
        build/src/ultra_os_setglobalintmask.o(.text);
        build/src/ultra_io_aisetfreq.o(.text);
        build/asm/39104.o(.text);
        build/src/ultra_gu_normalize.o(.text);
        build/asm/391A0.o(.text);
        build/src/func_801385B0.o(.text);
        build/asm/391C0.o(.text);
        build/asm/39530.o(.text);
        build/asm/39670.o(.text);
        build/asm/39970.o(.text);
        build/src/ultra_os_func_80138DB0.o(.text);
        build/asm/399E0.o(.text);
        build/src/ultra_os_func_80138F50.o(.text);
        build/src/ultra_os_settime.o(.text);
        build/src/ultra_os_func_80138FD0.o(.text);
        build/asm/39C40.o(.text);
        build/asm/39E20.o(.text);
        build/src/func_801393E0.o(.text);
        build/asm/3A060.o(.text);
        build/asm/3A250.o(.text);
        build/asm/3ADD0.o(.text);
        build/asm/3B1F0.o(.text);
        build/src/ultra_os_func_8013B2D0.o(.text);
        build/asm/3BF20.o(.text);
        build/asm/3C080.o(.text);
        build/src/ultra_os_func_8013B4E0.o(.text);
        build/asm/3C130.o(.text);
        build/asm/3C380.o(.text);
        build/asm/3C5B0.o(.text);
        build/asm/3C720.o(.text);
        build/src/ultra_os_settimer.o(.text);
        build/asm/3C960.o(.text);
        build/asm/3D420.o(.text);
        build/asm/3D5B0.o(.text);
        build/src/ultra_os_func_8013CC50.o(.text);
        build/src/ultra_os_dpsetnextbuf.o(.text);
        build/src/ultra_os_dp_busy.o(.text);
        build/src/func_8013CD80.o(.text);
        build/src/func_8013CD90.o(.text);
        build/asm/3D9A0.o(.text);
        build/src/getters.o(.text);
        build/asm/3DCC0.o(.text);
        build/asm/3DCF0.o(.text);
        build/src/ultra_os_func_8013D240.o(.text);
        build/asm/3DE98.o(.text);
        build/asm/3DEA0.o(.text);
        build/src/ultra_libc_ll_to_d.o(.text);
        build/asm/3E044.o(.text);
        build/asm/3E0B0.o(.text);
        build/src/ultra_os_ai_busy.o(.text);
        build/src/ultra_os_func_8013D820.o(.text);
        build/src/ultra_os_sp_setpc.o(.text);
        build/asm/3E4A0.o(.text);
        build/asm/3E580.o(.text);
        build/asm/3F3A0.o(.text);
        build/asm/40200.o(.text);
        build/asm/41400.o(.text);
        build/asm/41960.o(.text);
        build/asm/43B80.o(.text);
        build/asm/43BA0.o(.text);
        build/asm/59660.o(.text);
        build/asm/BD510.o(.text);
        build/asm/BD600.o(.text);
        build/asm/BF590.o(.text);
        build/asm/BF5B0.o(.text);
        build/asm/C1C10.o(.text);
        build/asm/C5CE0.o(.text);
        build/asm/DD530.o(.text);
        build/asm/DD740.o(.text);
        build/asm/DD800.o(.text);
        build/asm/DD860.o(.text);
        build/asm/DD8A0.o(.text);
        build/asm/DD8E0.o(.text);
        build/asm/DD920.o(.text);
        build/asm/DD960.o(.text);
        build/asm/DDF20.o(.text);
        build/asm/DDF40.o(.text);
        build/asm/DDFE0.o(.text);
        build/asm/DE0C0.o(.text);
        build/asm/DE100.o(.text);
        build/asm/DE1A0.o(.text);
        build/asm/DE320.o(.text);
        build/asm/DE460.o(.text);
        build/asm/DE4C0.o(.text);
        build/asm/DE580.o(.text);
        build/asm/DE660.o(.text);
        build/asm/DE760.o(.text);
        build/asm/DE780.o(.text);
        build/asm/DE850.o(.text);
        build/asm/DE870.o(.text);
        build/asm/DEE90.o(.text);
        build/asm/DEEE0.o(.text);
        build/asm/DEF50.o(.text);
        build/asm/DF620.o(.text);
        build/asm/DFEE0.o(.text);
        build/asm/E3140.o(.text);
        build/asm/110890.o(.text);
        build/asm/17E5C0.o(.text);
        build/asm/180C00.o(.text);
        build/asm/193E00.o(.text);
        build/asm/1A9D90.o(.text);
        build/asm/1C1C00.o(.text);
        build/asm/1D6680.o(.text);
        build/asm/1D6FB0.o(.text);
        build/asm/1D9A40.o(.text);
        build/asm/1DC790.o(.text);
        build/asm/1E05A0.o(.text);
        build/asm/1E1260.o(.text);
        build/asm/1E1400.o(.text);
        build/asm/1E5A20.o(.text);
        build/asm/203C50.o(.text);
        build/asm/203DF0.o(.text);
        build/asm/22E0F0.o(.text);
        build/asm/25EAA0.o(.text);
        build/asm/261190.o(.text);
        build/asm/266A70.o(.text);
        build/asm/26C1F0.o(.text);
        build/asm/26D7A0.o(.text);
        build/asm/26D7B0.o(.text);
        build/asm/26FA40.o(.text);
        build/asm/271200.o(.text);
        build/asm/2725B0.o(.text);
        build/asm/2729C0.o(.text);
        build/asm/272A60.o(.text);
        build/asm/272B30.o(.text);
        build/asm/275B30.o(.text);
        build/asm/320C50.o(.text);
        build/asm/33E080.o(.text);
        build/asm/340C30.o(.text);
        build/asm/342BB0.o(.text);
        build/asm/3BD4C0.o(.text);
        build/asm/3DD410.o(.text);
        build/asm/3E0C30.o(.text);
        build/asm/3E1260.o(.text);
        build/asm/3E17F0.o(.text);
        build/asm/3F3C10.o(.text);
        build/asm/3F51C0.o(.text);
        build/asm/40E200.o(.text);
        build/asm/4388F0.o(.text);
        build/asm/460000.o(.text);
        build/asm/485D70.o(.text);
        build/asm/49F230.o(.text);
        build/asm/49F8A0.o(.text);
        build/asm/4A0010.o(.text);
        build/asm/4A0240.o(.text);
        build/asm/4A0860.o(.text);
        build/asm/4A5380.o(.text);
        build/asm/4B3050.o(.text);
        build/asm/4B4C00.o(.text);
        build/asm/4BE370.o(.text);
        build/asm/4CACB0.o(.text);
        build/asm/504C00.o(.text);
        build/src/func_80605644.o(.text);
        build/asm/50628C.o(.text);
        build/asm/506290.o(.text);
        build/asm/5064F0.o(.text);
        build/src/func_80605D1C.o(.text);
        build/asm/506930.o(.text);
        build/asm/506DD0.o(.text);
        build/asm/506FB0.o(.text);
        build/asm/52E460.o(.text);
        build/asm/536330.o(.text);
        build/asm/53FC30.o(.text);
        build/asm/5BB100.o(.text);
        build/asm/5CF4F0.o(.text);
        build/asm/5D56F0.o(.text);
        build/asm/62A1F0.o(.text);
        build/asm/6B54A0.o(.text);
        build/asm/6B81E0.o(.text);
        build/asm/714350.o(.text);
        build/asm/732FD0.o(.text);
        build/asm/734B60.o(.text);
        build/asm/7724A0.o(.text);
        build/asm/772AF0.o(.text);
        build/asm/773C50.o(.text);
        build/asm/779730.o(.text);
        build/asm/780880.o(.text);
        build/asm/780CA0.o(.text);
        build/asm/780D90.o(.text);
        build/asm/78A3F0.o(.text);
        build/asm/7C0CA0.o(.text);
        build/asm/7FC4B0.o(.text);
        build/asm/8003C0.o(.text);
        build/asm/80F2C0.o(.text);
        build/asm/81AB30.o(.text);
        build/asm/81B270.o(.text);
        build/asm/81B9D0.o(.text);
        build/asm/81C0B0.o(.text);
        build/asm/81C730.o(.text);
        build/asm/81DDA0.o(.text);
        build/asm/831D70.o(.text);
        build/asm/86FD40.o(.text);
        build/asm/9FF2F0.o(.text);
        build/asm/AA4EC0.o(.text);
        build/asm/AA5150.o(.text);
        build/asm/AC2740.o(.text);
        build/asm/AC70A0.o(.text);
        build/asm/AD0A00.o(.text);
        build/asm/ADDA00.o(.text);
        build/asm/AE1960.o(.text);
        build/asm/AEC350.o(.text);
        build/asm/AEFC00.o(.text);
        build/asm/AEFC10.o(.text);
        build/asm/B00CA0.o(.text);
        build/asm/BAFBE0.o(.text);
        . = ALIGN(., 16);
        main_TEXT_END = .;
        main_TEXT_SIZE = ABSOLUTE(main_TEXT_END - main_TEXT_START);
        main_DATA_START = .;
        build/asm/1000.o(.data);
        build/src/func_8010046C.o(.data);
        build/src/boot_hw_probe.o(.data);
        build/src/func_801004E0.o(.data);
        build/asm/1110.o(.data);
        build/src/func_80100920.o(.data);
        build/asm/1528.o(.data);
        build/src/func_801009A0.o(.data);
        build/src/func_80100A08.o(.data);
        build/asm/1664.o(.data);
        build/src/func_80100C74.o(.data);
        build/asm/1ABC.o(.data);
        build/src/func_80101810.o(.data);
        build/asm/2498.o(.data);
        build/src/func_801024E4.o(.data);
        build/asm/3110.o(.data);
        build/src/func_80102954.o(.data);
        build/src/func_801029BC.o(.data);
        build/asm/3610.o(.data);
        build/src/func_80102C20.o(.data);
        build/asm/3894.o(.data);
        build/src/func_8010345C.o(.data);
        build/asm/4130.o(.data);
        build/asm/4680.o(.data);
        build/src/func_801047D4.o(.data);
        build/src/func_80104838.o(.data);
        build/asm/5510.o(.data);
        build/src/func_801049C4.o(.data);
        build/asm/5624.o(.data);
        build/src/func_80104AF8.o(.data);
        build/asm/5770.o(.data);
        build/src/func_80104D94.o(.data);
        build/src/func_80104DE8.o(.data);
        build/src/func_80104E7C.o(.data);
        build/src/func_80104EA4.o(.data);
        build/asm/5B24.o(.data);
        build/src/func_801053F0.o(.data);
        build/src/func_80105418.o(.data);
        build/asm/60D0.o(.data);
        build/asm/637C.o(.data);
        build/src/func_801067EC.o(.data);
        build/src/func_80106804.o(.data);
        build/src/func_80106878.o(.data);
        build/asm/7508.o(.data);
        build/src/func_80106E24.o(.data);
        build/src/func_80106E5C.o(.data);
        build/src/func_80106EC0.o(.data);
        build/src/func_80106F10.o(.data);
        build/asm/7B8C.o(.data);
        build/src/func_80107354.o(.data);
        build/asm/7FAC.o(.data);
        build/src/func_801075FC.o(.data);
        build/asm/82F0.o(.data);
        build/src/func_80107850.o(.data);
        build/asm/845C.o(.data);
        build/src/func_801078C4.o(.data);
        build/asm/8510.o(.data);
        build/src/func_801079B8.o(.data);
        build/src/func_80107A04.o(.data);
        build/asm/8814.o(.data);
        build/asm/8820.o(.data);
        build/src/func_80107CBC.o(.data);
        build/asm/8914.o(.data);
        build/src/func_80107E80.o(.data);
        build/src/func_80107EF8.o(.data);
        build/src/func_80107F24.o(.data);
        build/src/func_80108000.o(.data);
        build/src/func_80108024.o(.data);
        build/src/func_801080A0.o(.data);
        build/asm/8D18.o(.data);
        build/src/func_801081F0.o(.data);
        build/src/func_8010821C.o(.data);
        build/src/func_801082D8.o(.data);
        build/src/func_80108360.o(.data);
        build/asm/8F94.o(.data);
        build/src/func_80108460.o(.data);
        build/src/func_8010848C.o(.data);
        build/src/func_801084F4.o(.data);
        build/src/func_80108560.o(.data);
        build/src/func_801086B8.o(.data);
        build/src/func_80108724.o(.data);
        build/src/func_80108814.o(.data);
        build/src/func_8010888C.o(.data);
        build/src/func_801088B8.o(.data);
        build/src/func_80108930.o(.data);
        build/src/func_8010898C.o(.data);
        build/src/func_80108A04.o(.data);
        build/asm/9828.o(.data);
        build/src/func_80109760.o(.data);
        build/asm/A390.o(.data);
        build/src/func_80109918.o(.data);
        build/src/func_80109B1C.o(.data);
        build/asm/A77C.o(.data);
        build/src/func_80109C94.o(.data);
        build/asm/A90C.o(.data);
        build/src/func_80109E20.o(.data);
        build/asm/AA94.o(.data);
        build/src/func_8010A410.o(.data);
        build/src/func_8010A490.o(.data);
        build/src/func_8010A52C.o(.data);
        build/asm/B1F8.o(.data);
        build/src/func_8010A740.o(.data);
        build/src/func_8010A828.o(.data);
        build/src/func_8010A8A4.o(.data);
        build/src/func_8010A92C.o(.data);
        build/src/func_8010A9D8.o(.data);
        build/src/func_8010AA0C.o(.data);
        build/src/func_8010AA84.o(.data);
        build/src/func_8010AAD8.o(.data);
        build/src/func_8010AB30.o(.data);
        build/src/func_8010ABAC.o(.data);
        build/src/func_8010AC28.o(.data);
        build/src/func_8010ACAC.o(.data);
        build/src/func_8010AD14.o(.data);
        build/src/func_8010AD88.o(.data);
        build/asm/B9A0.o(.data);
        build/src/func_8010AE4C.o(.data);
        build/asm/BAC4.o(.data);
        build/src/func_8010B6F0.o(.data);
        build/src/func_8010B740.o(.data);
        build/src/func_8010B774.o(.data);
        build/src/func_8010B808.o(.data);
        build/src/func_8010B830.o(.data);
        build/asm/C480.o(.data);
        build/src/func_8010B998.o(.data);
        build/asm/C5B0.o(.data);
        build/src/func_8010BC2C.o(.data);
        build/asm/C8A8.o(.data);
        build/src/func_8010BD44.o(.data);
        build/src/func_8010BDDC.o(.data);
        build/src/func_8010BE5C.o(.data);
        build/src/func_8010BEAC.o(.data);
        build/asm/CCD8.o(.data);
        build/src/func_8010C1CC.o(.data);
        build/src/func_8010C220.o(.data);
        build/asm/CE74.o(.data);
        build/asm/D150.o(.data);
        build/src/func_8010C5B4.o(.data);
        build/src/func_8010C6C0.o(.data);
        build/src/func_8010C704.o(.data);
        build/src/func_8010C7CC.o(.data);
        build/asm/D43C.o(.data);
        build/src/func_8010FAFC.o(.data);
        build/src/func_8010FB34.o(.data);
        build/asm/107C4.o(.data);
        build/src/func_8011054C.o(.data);
        build/asm/11184.o(.data);
        build/src/func_80111090.o(.data);
        build/asm/11CBC.o(.data);
        build/src/func_80111230.o(.data);
        build/asm/11E68.o(.data);
        build/src/func_80114D60.o(.data);
        build/asm/159F0.o(.data);
        build/src/func_80114F98.o(.data);
        build/asm/15BF0.o(.data);
        build/src/func_801153EC.o(.data);
        build/asm/16048.o(.data);
        build/src/func_80115890.o(.data);
        build/asm/164E8.o(.data);
        build/src/func_8011679C.o(.data);
        build/asm/173F4.o(.data);
        build/src/func_80116C88.o(.data);
        build/asm/178E0.o(.data);
        build/src/func_80117768.o(.data);
        build/asm/183D8.o(.data);
        build/src/func_80118CD0.o(.data);
        build/asm/198DC.o(.data);
        build/src/func_801191D8.o(.data);
        build/asm/19E78.o(.data);
        build/src/func_80119960.o(.data);
        build/asm/1A594.o(.data);
        build/src/func_80119CD0.o(.data);
        build/src/func_80119D48.o(.data);
        build/asm/1A960.o(.data);
        build/src/func_80119DB0.o(.data);
        build/asm/1AA78.o(.data);
        build/asm/1AF60.o(.data);
        build/src/vec3.o(.data);
        build/asm/1B130.o(.data);
        build/src/func_8011A88C.o(.data);
        build/asm/1B4B8.o(.data);
        build/src/func_8011AA40.o(.data);
        build/asm/1B688.o(.data);
        build/src/func_8011AF30.o(.data);
        build/asm/1BB80.o(.data);
        build/asm/1BCF0.o(.data);
        build/src/func_8011B7FC.o(.data);
        build/asm/1C470.o(.data);
        build/src/func_8011BB48.o(.data);
        build/asm/1C7C4.o(.data);
        build/src/func_8011BFAC.o(.data);
        build/asm/1CC24.o(.data);
        build/src/func_8011C664.o(.data);
        build/asm/1D2C8.o(.data);
        build/src/func_8011C8F4.o(.data);
        build/asm/1D54C.o(.data);
        build/src/func_8011CB14.o(.data);
        build/asm/1D76C.o(.data);
        build/src/func_8011D078.o(.data);
        build/src/func_8011D0C4.o(.data);
        build/src/func_8011D184.o(.data);
        build/src/func_8011D1F0.o(.data);
        build/asm/1DE6C.o(.data);
        build/src/func_8011D648.o(.data);
        build/asm/1E29C.o(.data);
        build/src/func_8011D9A4.o(.data);
        build/asm/1E608.o(.data);
        build/src/func_8011DF78.o(.data);
        build/src/func_8011DFCC.o(.data);
        build/asm/1ED00.o(.data);
        build/src/func_8011E1CC.o(.data);
        build/src/func_8011E20C.o(.data);
        build/src/func_8011E25C.o(.data);
        build/src/func_8011E2B0.o(.data);
        build/src/func_8011E37C.o(.data);
        build/src/func_8011E3BC.o(.data);
        build/src/func_8011E40C.o(.data);
        build/src/func_8011E460.o(.data);
        build/src/func_8011E4F0.o(.data);
        build/src/func_8011E528.o(.data);
        build/src/func_8011E574.o(.data);
        build/src/func_8011E5C0.o(.data);
        build/src/func_8011E650.o(.data);
        build/src/func_8011E688.o(.data);
        build/src/func_8011E6D4.o(.data);
        build/asm/1F320.o(.data);
        build/asm/1F960.o(.data);
        build/src/func_8011FCA4.o(.data);
        build/src/func_8011FCE8.o(.data);
        build/asm/2092C.o(.data);
        build/src/func_8011FD40.o(.data);
        build/asm/20974.o(.data);
        build/src/func_8011FDC8.o(.data);
        build/asm/20A08.o(.data);
        build/src/func_8011FFD8.o(.data);
        build/src/func_80120030.o(.data);
        build/asm/20C9C.o(.data);
        build/src/func_80120BAC.o(.data);
        build/src/func_80120BC4.o(.data);
        build/asm/21840.o(.data);
        build/src/func_801222D8.o(.data);
        build/src/func_80122300.o(.data);
        build/asm/22F74.o(.data);
        build/src/func_801226BC.o(.data);
        build/asm/2338C.o(.data);
        build/src/func_80122C0C.o(.data);
        build/asm/23828.o(.data);
        build/src/sound_chan_setMidi.o(.data);
        build/src/sound_chan_misc.o(.data);
        build/asm/23C74.o(.data);
        build/src/func_80123104.o(.data);
        build/asm/23D1C.o(.data);
        build/src/func_801239CC.o(.data);
        build/asm/245E0.o(.data);
        build/src/func_80124200.o(.data);
        build/asm/24E28.o(.data);
        build/src/func_80124F54.o(.data);
        build/asm/25B78.o(.data);
        build/src/func_80125918.o(.data);
        build/asm/26538.o(.data);
        build/src/func_80126140.o(.data);
        build/src/func_80126170.o(.data);
        build/asm/26DB8.o(.data);
        build/src/func_801287F0.o(.data);
        build/src/func_80128810.o(.data);
        build/src/func_80128830.o(.data);
        build/src/func_80128850.o(.data);
        build/src/func_801288C0.o(.data);
        build/src/func_8012891C.o(.data);
        build/src/func_80128930.o(.data);
        build/src/func_80128970.o(.data);
        build/asm/295C0.o(.data);
        build/asm/29610.o(.data);
        build/src/func_80129160.o(.data);
        build/asm/29D68.o(.data);
        build/src/func_80129C10.o(.data);
        build/asm/2A8D0.o(.data);
        build/asm/2A970.o(.data);
        build/asm/2ACC0.o(.data);
        build/asm/2AD70.o(.data);
        build/src/func_8012A390.o(.data);
        build/asm/2AFD0.o(.data);
        build/asm/2B060.o(.data);
        build/src/func_8012A4C0.o(.data);
        build/src/func_8012A500.o(.data);
        build/asm/2B120.o(.data);
        build/asm/2B1B0.o(.data);
        build/asm/2B240.o(.data);
        build/asm/2B2A0.o(.data);
        build/src/func_8012AB70.o(.data);
        build/asm/2B850.o(.data);
        build/src/func_8012AC9C.o(.data);
        build/asm/2B8C0.o(.data);
        build/asm/2B920.o(.data);
        build/src/func_8012B1E0.o(.data);
        build/src/func_8012B288.o(.data);
        build/src/func_8012B330.o(.data);
        build/src/func_8012B3BC.o(.data);
        build/asm/2C0A8.o(.data);
        build/asm/2C0B0.o(.data);
        build/src/func_8012B5D0.o(.data);
        build/asm/2C200.o(.data);
        build/src/func_8012B934.o(.data);
        build/asm/2C54C.o(.data);
        build/asm/2CE60.o(.data);
        build/src/func_8012C338.o(.data);
        build/asm/2CF70.o(.data);
        build/asm/2DBE0.o(.data);
        build/asm/2DED0.o(.data);
        build/src/func_8012DE50.o(.data);
        build/src/func_8012DE70.o(.data);
        build/asm/2EAB0.o(.data);
        build/asm/2EB10.o(.data);
        build/asm/2EBB0.o(.data);
        build/src/func_8012E03C.o(.data);
        build/asm/2ED28.o(.data);
        build/asm/2ED30.o(.data);
        build/src/func_8012FE34.o(.data);
        build/asm/30A6C.o(.data);
        build/asm/30C80.o(.data);
        build/src/func_801311F8.o(.data);
        build/asm/31E5C.o(.data);
        build/src/func_801312CC.o(.data);
        build/asm/31F3C.o(.data);
        build/src/func_801317E4.o(.data);
        build/asm/32440.o(.data);
        build/src/func_80131A54.o(.data);
        build/src/func_80131A90.o(.data);
        build/asm/326B0.o(.data);
        build/src/func_80131CFC.o(.data);
        build/asm/32960.o(.data);
        build/src/func_80131FC0.o(.data);
        build/asm/32BF8.o(.data);
        build/src/func_80132160.o(.data);
        build/asm/32D90.o(.data);
        build/src/func_801321F0.o(.data);
        build/src/func_80132240.o(.data);
        build/asm/32E60.o(.data);
        build/asm/32ED0.o(.data);
        build/src/func_80132400.o(.data);
        build/asm/33030.o(.data);
        build/src/func_80132440.o(.data);
        build/asm/33070.o(.data);
        build/asm/33110.o(.data);
        build/src/func_801325A0.o(.data);
        build/asm/331B0.o(.data);
        build/asm/33230.o(.data);
        build/asm/33380.o(.data);
        build/asm/33580.o(.data);
        build/src/func_80132E8C.o(.data);
        build/asm/33AD0.o(.data);
        build/src/ultra_libc_ll.o(.data);
        build/asm/33EA0.o(.data);
        build/asm/34880.o(.data);
        build/asm/34E30.o(.data);
        build/src/func_80134600.o(.data);
        build/asm/352C0.o(.data);
        build/asm/35600.o(.data);
        build/asm/35750.o(.data);
        build/src/ultra_os_virtualtophysical.o(.data);
        build/asm/359B0.o(.data);
        build/asm/35A30.o(.data);
        build/src/ultra_os_pirawread.o(.data);
        build/asm/35E50.o(.data);
        build/src/ultra_os_func_80135270.o(.data);
        build/asm/35EB0.o(.data);
        build/src/ultra_os_sprawdma.o(.data);
        build/asm/36160.o(.data);
        build/src/ultra_os_func_80135610.o(.data);
        build/src/ultra_os_func_80135660.o(.data);
        build/src/ultra_os_func_801356D0.o(.data);
        build/src/func_80135720.o(.data);
        build/src/ultra_os_func_80135740.o(.data);
        build/asm/363B0.o(.data);
        build/asm/36470.o(.data);
        build/src/func_801359E0.o(.data);
        build/asm/366A0.o(.data);
        build/src/ultra_os_func_80136020.o(.data);
        build/src/func_80136090.o(.data);
        build/src/ultra_os_func_801360A0.o(.data);
        build/src/func_80136124.o(.data);
        build/asm/36D4C.o(.data);
        build/src/func_80136150.o(.data);
        build/src/func_801361B0.o(.data);
        build/asm/36E10.o(.data);
        build/src/func_80136398.o(.data);
        build/asm/36FC8.o(.data);
        build/asm/37080.o(.data);
        build/asm/37290.o(.data);
        build/asm/37F50.o(.data);
        build/src/func_801374B0.o(.data);
        build/src/func_801374D4.o(.data);
        build/asm/38130.o(.data);
        build/asm/38180.o(.data);
        build/src/memcpy.o(.data);
        build/src/strlen.o(.data);
        build/src/func_801376B4.o(.data);
        build/src/ultra_os_createmesgqueue.o(.data);
        build/asm/38330.o(.data);
        build/asm/383B0.o(.data);
        build/src/ultra_os_sp_busy.o(.data);
        build/src/ultra_os_si_busy.o(.data);
        build/asm/384C0.o(.data);
        build/src/func_80137AF0.o(.data);
        build/asm/38708.o(.data);
        build/src/ultra_os_func_80137B10.o(.data);
        build/asm/38760.o(.data);
        build/src/ultra_os_gettime.o(.data);
        build/asm/38B70.o(.data);
        build/src/ultra_os_setglobalintmask.o(.data);
        build/src/ultra_io_aisetfreq.o(.data);
        build/asm/39104.o(.data);
        build/src/ultra_gu_normalize.o(.data);
        build/asm/391A0.o(.data);
        build/src/func_801385B0.o(.data);
        build/asm/391C0.o(.data);
        build/asm/39530.o(.data);
        build/asm/39670.o(.data);
        build/asm/39970.o(.data);
        build/src/ultra_os_func_80138DB0.o(.data);
        build/asm/399E0.o(.data);
        build/src/ultra_os_func_80138F50.o(.data);
        build/src/ultra_os_settime.o(.data);
        build/src/ultra_os_func_80138FD0.o(.data);
        build/asm/39C40.o(.data);
        build/asm/39E20.o(.data);
        build/src/func_801393E0.o(.data);
        build/asm/3A060.o(.data);
        build/asm/3A250.o(.data);
        build/asm/3ADD0.o(.data);
        build/asm/3B1F0.o(.data);
        build/src/ultra_os_func_8013B2D0.o(.data);
        build/asm/3BF20.o(.data);
        build/asm/3C080.o(.data);
        build/src/ultra_os_func_8013B4E0.o(.data);
        build/asm/3C130.o(.data);
        build/asm/3C380.o(.data);
        build/asm/3C5B0.o(.data);
        build/asm/3C720.o(.data);
        build/src/ultra_os_settimer.o(.data);
        build/asm/3C960.o(.data);
        build/asm/3D420.o(.data);
        build/asm/3D5B0.o(.data);
        build/src/ultra_os_func_8013CC50.o(.data);
        build/src/ultra_os_dpsetnextbuf.o(.data);
        build/src/ultra_os_dp_busy.o(.data);
        build/src/func_8013CD80.o(.data);
        build/src/func_8013CD90.o(.data);
        build/asm/3D9A0.o(.data);
        build/src/getters.o(.data);
        build/asm/3DCC0.o(.data);
        build/asm/3DCF0.o(.data);
        build/src/ultra_os_func_8013D240.o(.data);
        build/asm/3DE98.o(.data);
        build/asm/3DEA0.o(.data);
        build/src/ultra_libc_ll_to_d.o(.data);
        build/asm/3E044.o(.data);
        build/asm/3E0B0.o(.data);
        build/src/ultra_os_ai_busy.o(.data);
        build/src/ultra_os_func_8013D820.o(.data);
        build/src/ultra_os_sp_setpc.o(.data);
        build/asm/3E4A0.o(.data);
        build/asm/3E580.o(.data);
        build/asm/3F3A0.o(.data);
        build/asm/40200.o(.data);
        build/asm/41400.o(.data);
        build/asm/41960.o(.data);
        build/asm/43B80.o(.data);
        build/asm/43BA0.o(.data);
        build/asm/59660.o(.data);
        build/asm/BD510.o(.data);
        build/asm/BD600.o(.data);
        build/asm/BF590.o(.data);
        build/asm/BF5B0.o(.data);
        build/asm/C1C10.o(.data);
        build/asm/C5CE0.o(.data);
        build/asm/DD530.o(.data);
        build/asm/DD740.o(.data);
        build/asm/DD800.o(.data);
        build/asm/DD860.o(.data);
        build/asm/DD8A0.o(.data);
        build/asm/DD8E0.o(.data);
        build/asm/DD920.o(.data);
        build/asm/DD960.o(.data);
        build/asm/DDF20.o(.data);
        build/asm/DDF40.o(.data);
        build/asm/DDFE0.o(.data);
        build/asm/DE0C0.o(.data);
        build/asm/DE100.o(.data);
        build/asm/DE1A0.o(.data);
        build/asm/DE320.o(.data);
        build/asm/DE460.o(.data);
        build/asm/DE4C0.o(.data);
        build/asm/DE580.o(.data);
        build/asm/DE660.o(.data);
        build/asm/DE760.o(.data);
        build/asm/DE780.o(.data);
        build/asm/DE850.o(.data);
        build/asm/DE870.o(.data);
        build/asm/DEE90.o(.data);
        build/asm/DEEE0.o(.data);
        build/asm/DEF50.o(.data);
        build/asm/DF620.o(.data);
        build/asm/DFEE0.o(.data);
        build/asm/E3140.o(.data);
        build/asm/110890.o(.data);
        build/asm/17E5C0.o(.data);
        build/asm/180C00.o(.data);
        build/asm/193E00.o(.data);
        build/asm/1A9D90.o(.data);
        build/asm/1C1C00.o(.data);
        build/asm/1D6680.o(.data);
        build/asm/1D6FB0.o(.data);
        build/asm/1D9A40.o(.data);
        build/asm/1DC790.o(.data);
        build/asm/1E05A0.o(.data);
        build/asm/1E1260.o(.data);
        build/asm/1E1400.o(.data);
        build/asm/1E5A20.o(.data);
        build/asm/203C50.o(.data);
        build/asm/203DF0.o(.data);
        build/asm/22E0F0.o(.data);
        build/asm/25EAA0.o(.data);
        build/asm/261190.o(.data);
        build/asm/266A70.o(.data);
        build/asm/26C1F0.o(.data);
        build/asm/26D7A0.o(.data);
        build/asm/26D7B0.o(.data);
        build/asm/26FA40.o(.data);
        build/asm/271200.o(.data);
        build/asm/2725B0.o(.data);
        build/asm/2729C0.o(.data);
        build/asm/272A60.o(.data);
        build/asm/272B30.o(.data);
        build/asm/275B30.o(.data);
        build/asm/320C50.o(.data);
        build/asm/33E080.o(.data);
        build/asm/340C30.o(.data);
        build/asm/342BB0.o(.data);
        build/asm/3BD4C0.o(.data);
        build/asm/3DD410.o(.data);
        build/asm/3E0C30.o(.data);
        build/asm/3E1260.o(.data);
        build/asm/3E17F0.o(.data);
        build/asm/3F3C10.o(.data);
        build/asm/3F51C0.o(.data);
        build/asm/40E200.o(.data);
        build/asm/4388F0.o(.data);
        build/asm/460000.o(.data);
        build/asm/485D70.o(.data);
        build/asm/49F230.o(.data);
        build/asm/49F8A0.o(.data);
        build/asm/4A0010.o(.data);
        build/asm/4A0240.o(.data);
        build/asm/4A0860.o(.data);
        build/asm/4A5380.o(.data);
        build/asm/4B3050.o(.data);
        build/asm/4B4C00.o(.data);
        build/asm/4BE370.o(.data);
        build/asm/4CACB0.o(.data);
        build/asm/504C00.o(.data);
        build/src/func_80605644.o(.data);
        build/asm/50628C.o(.data);
        build/asm/506290.o(.data);
        build/asm/5064F0.o(.data);
        build/src/func_80605D1C.o(.data);
        build/asm/506930.o(.data);
        build/asm/506DD0.o(.data);
        build/asm/506FB0.o(.data);
        build/asm/52E460.o(.data);
        build/asm/536330.o(.data);
        build/asm/53FC30.o(.data);
        build/asm/5BB100.o(.data);
        build/asm/5CF4F0.o(.data);
        build/asm/5D56F0.o(.data);
        build/asm/62A1F0.o(.data);
        build/asm/6B54A0.o(.data);
        build/asm/6B81E0.o(.data);
        build/asm/714350.o(.data);
        build/asm/732FD0.o(.data);
        build/asm/734B60.o(.data);
        build/asm/7724A0.o(.data);
        build/asm/772AF0.o(.data);
        build/asm/773C50.o(.data);
        build/asm/779730.o(.data);
        build/asm/780880.o(.data);
        build/asm/780CA0.o(.data);
        build/asm/780D90.o(.data);
        build/asm/78A3F0.o(.data);
        build/asm/7C0CA0.o(.data);
        build/asm/7FC4B0.o(.data);
        build/asm/8003C0.o(.data);
        build/asm/80F2C0.o(.data);
        build/asm/81AB30.o(.data);
        build/asm/81B270.o(.data);
        build/asm/81B9D0.o(.data);
        build/asm/81C0B0.o(.data);
        build/asm/81C730.o(.data);
        build/asm/81DDA0.o(.data);
        build/asm/831D70.o(.data);
        build/asm/86FD40.o(.data);
        build/asm/9FF2F0.o(.data);
        build/asm/AA4EC0.o(.data);
        build/asm/AA5150.o(.data);
        build/asm/AC2740.o(.data);
        build/asm/AC70A0.o(.data);
        build/asm/AD0A00.o(.data);
        build/asm/ADDA00.o(.data);
        build/asm/AE1960.o(.data);
        build/asm/AEC350.o(.data);
        build/asm/AEFC00.o(.data);
        build/asm/AEFC10.o(.data);
        build/asm/B00CA0.o(.data);
        build/asm/BAFBE0.o(.data);
        . = ALIGN(., 16);
        main_DATA_END = .;
        main_DATA_SIZE = ABSOLUTE(main_DATA_END - main_DATA_START);
        main_RODATA_START = .;
        build/asm/1000.o(.rodata);
        build/src/func_8010046C.o(.rodata);
        build/src/boot_hw_probe.o(.rodata);
        build/src/func_801004E0.o(.rodata);
        build/asm/1110.o(.rodata);
        build/src/func_80100920.o(.rodata);
        build/asm/1528.o(.rodata);
        build/src/func_801009A0.o(.rodata);
        build/src/func_80100A08.o(.rodata);
        build/asm/1664.o(.rodata);
        build/src/func_80100C74.o(.rodata);
        build/asm/1ABC.o(.rodata);
        build/src/func_80101810.o(.rodata);
        build/asm/2498.o(.rodata);
        build/src/func_801024E4.o(.rodata);
        build/asm/3110.o(.rodata);
        build/src/func_80102954.o(.rodata);
        build/src/func_801029BC.o(.rodata);
        build/asm/3610.o(.rodata);
        build/src/func_80102C20.o(.rodata);
        build/asm/3894.o(.rodata);
        build/src/func_8010345C.o(.rodata);
        build/asm/4130.o(.rodata);
        build/asm/4680.o(.rodata);
        build/src/func_801047D4.o(.rodata);
        build/src/func_80104838.o(.rodata);
        build/asm/5510.o(.rodata);
        build/src/func_801049C4.o(.rodata);
        build/asm/5624.o(.rodata);
        build/src/func_80104AF8.o(.rodata);
        build/asm/5770.o(.rodata);
        build/src/func_80104D94.o(.rodata);
        build/src/func_80104DE8.o(.rodata);
        build/src/func_80104E7C.o(.rodata);
        build/src/func_80104EA4.o(.rodata);
        build/asm/5B24.o(.rodata);
        build/src/func_801053F0.o(.rodata);
        build/src/func_80105418.o(.rodata);
        build/asm/60D0.o(.rodata);
        build/asm/637C.o(.rodata);
        build/src/func_801067EC.o(.rodata);
        build/src/func_80106804.o(.rodata);
        build/src/func_80106878.o(.rodata);
        build/asm/7508.o(.rodata);
        build/src/func_80106E24.o(.rodata);
        build/src/func_80106E5C.o(.rodata);
        build/src/func_80106EC0.o(.rodata);
        build/src/func_80106F10.o(.rodata);
        build/asm/7B8C.o(.rodata);
        build/src/func_80107354.o(.rodata);
        build/asm/7FAC.o(.rodata);
        build/src/func_801075FC.o(.rodata);
        build/asm/82F0.o(.rodata);
        build/src/func_80107850.o(.rodata);
        build/asm/845C.o(.rodata);
        build/src/func_801078C4.o(.rodata);
        build/asm/8510.o(.rodata);
        build/src/func_801079B8.o(.rodata);
        build/src/func_80107A04.o(.rodata);
        build/asm/8814.o(.rodata);
        build/asm/8820.o(.rodata);
        build/src/func_80107CBC.o(.rodata);
        build/asm/8914.o(.rodata);
        build/src/func_80107E80.o(.rodata);
        build/src/func_80107EF8.o(.rodata);
        build/src/func_80107F24.o(.rodata);
        build/src/func_80108000.o(.rodata);
        build/src/func_80108024.o(.rodata);
        build/src/func_801080A0.o(.rodata);
        build/asm/8D18.o(.rodata);
        build/src/func_801081F0.o(.rodata);
        build/src/func_8010821C.o(.rodata);
        build/src/func_801082D8.o(.rodata);
        build/src/func_80108360.o(.rodata);
        build/asm/8F94.o(.rodata);
        build/src/func_80108460.o(.rodata);
        build/src/func_8010848C.o(.rodata);
        build/src/func_801084F4.o(.rodata);
        build/src/func_80108560.o(.rodata);
        build/src/func_801086B8.o(.rodata);
        build/src/func_80108724.o(.rodata);
        build/src/func_80108814.o(.rodata);
        build/src/func_8010888C.o(.rodata);
        build/src/func_801088B8.o(.rodata);
        build/src/func_80108930.o(.rodata);
        build/src/func_8010898C.o(.rodata);
        build/src/func_80108A04.o(.rodata);
        build/asm/9828.o(.rodata);
        build/src/func_80109760.o(.rodata);
        build/asm/A390.o(.rodata);
        build/src/func_80109918.o(.rodata);
        build/src/func_80109B1C.o(.rodata);
        build/asm/A77C.o(.rodata);
        build/src/func_80109C94.o(.rodata);
        build/asm/A90C.o(.rodata);
        build/src/func_80109E20.o(.rodata);
        build/asm/AA94.o(.rodata);
        build/src/func_8010A410.o(.rodata);
        build/src/func_8010A490.o(.rodata);
        build/src/func_8010A52C.o(.rodata);
        build/asm/B1F8.o(.rodata);
        build/src/func_8010A740.o(.rodata);
        build/src/func_8010A828.o(.rodata);
        build/src/func_8010A8A4.o(.rodata);
        build/src/func_8010A92C.o(.rodata);
        build/src/func_8010A9D8.o(.rodata);
        build/src/func_8010AA0C.o(.rodata);
        build/src/func_8010AA84.o(.rodata);
        build/src/func_8010AAD8.o(.rodata);
        build/src/func_8010AB30.o(.rodata);
        build/src/func_8010ABAC.o(.rodata);
        build/src/func_8010AC28.o(.rodata);
        build/src/func_8010ACAC.o(.rodata);
        build/src/func_8010AD14.o(.rodata);
        build/src/func_8010AD88.o(.rodata);
        build/asm/B9A0.o(.rodata);
        build/src/func_8010AE4C.o(.rodata);
        build/asm/BAC4.o(.rodata);
        build/src/func_8010B6F0.o(.rodata);
        build/src/func_8010B740.o(.rodata);
        build/src/func_8010B774.o(.rodata);
        build/src/func_8010B808.o(.rodata);
        build/src/func_8010B830.o(.rodata);
        build/asm/C480.o(.rodata);
        build/src/func_8010B998.o(.rodata);
        build/asm/C5B0.o(.rodata);
        build/src/func_8010BC2C.o(.rodata);
        build/asm/C8A8.o(.rodata);
        build/src/func_8010BD44.o(.rodata);
        build/src/func_8010BDDC.o(.rodata);
        build/src/func_8010BE5C.o(.rodata);
        build/src/func_8010BEAC.o(.rodata);
        build/asm/CCD8.o(.rodata);
        build/src/func_8010C1CC.o(.rodata);
        build/src/func_8010C220.o(.rodata);
        build/asm/CE74.o(.rodata);
        build/asm/D150.o(.rodata);
        build/src/func_8010C5B4.o(.rodata);
        build/src/func_8010C6C0.o(.rodata);
        build/src/func_8010C704.o(.rodata);
        build/src/func_8010C7CC.o(.rodata);
        build/asm/D43C.o(.rodata);
        build/src/func_8010FAFC.o(.rodata);
        build/src/func_8010FB34.o(.rodata);
        build/asm/107C4.o(.rodata);
        build/src/func_8011054C.o(.rodata);
        build/asm/11184.o(.rodata);
        build/src/func_80111090.o(.rodata);
        build/asm/11CBC.o(.rodata);
        build/src/func_80111230.o(.rodata);
        build/asm/11E68.o(.rodata);
        build/src/func_80114D60.o(.rodata);
        build/asm/159F0.o(.rodata);
        build/src/func_80114F98.o(.rodata);
        build/asm/15BF0.o(.rodata);
        build/src/func_801153EC.o(.rodata);
        build/asm/16048.o(.rodata);
        build/src/func_80115890.o(.rodata);
        build/asm/164E8.o(.rodata);
        build/src/func_8011679C.o(.rodata);
        build/asm/173F4.o(.rodata);
        build/src/func_80116C88.o(.rodata);
        build/asm/178E0.o(.rodata);
        build/src/func_80117768.o(.rodata);
        build/asm/183D8.o(.rodata);
        build/src/func_80118CD0.o(.rodata);
        build/asm/198DC.o(.rodata);
        build/src/func_801191D8.o(.rodata);
        build/asm/19E78.o(.rodata);
        build/src/func_80119960.o(.rodata);
        build/asm/1A594.o(.rodata);
        build/src/func_80119CD0.o(.rodata);
        build/src/func_80119D48.o(.rodata);
        build/asm/1A960.o(.rodata);
        build/src/func_80119DB0.o(.rodata);
        build/asm/1AA78.o(.rodata);
        build/asm/1AF60.o(.rodata);
        build/src/vec3.o(.rodata);
        build/asm/1B130.o(.rodata);
        build/src/func_8011A88C.o(.rodata);
        build/asm/1B4B8.o(.rodata);
        build/src/func_8011AA40.o(.rodata);
        build/asm/1B688.o(.rodata);
        build/src/func_8011AF30.o(.rodata);
        build/asm/1BB80.o(.rodata);
        build/asm/1BCF0.o(.rodata);
        build/src/func_8011B7FC.o(.rodata);
        build/asm/1C470.o(.rodata);
        build/src/func_8011BB48.o(.rodata);
        build/asm/1C7C4.o(.rodata);
        build/src/func_8011BFAC.o(.rodata);
        build/asm/1CC24.o(.rodata);
        build/src/func_8011C664.o(.rodata);
        build/asm/1D2C8.o(.rodata);
        build/src/func_8011C8F4.o(.rodata);
        build/asm/1D54C.o(.rodata);
        build/src/func_8011CB14.o(.rodata);
        build/asm/1D76C.o(.rodata);
        build/src/func_8011D078.o(.rodata);
        build/src/func_8011D0C4.o(.rodata);
        build/src/func_8011D184.o(.rodata);
        build/src/func_8011D1F0.o(.rodata);
        build/asm/1DE6C.o(.rodata);
        build/src/func_8011D648.o(.rodata);
        build/asm/1E29C.o(.rodata);
        build/src/func_8011D9A4.o(.rodata);
        build/asm/1E608.o(.rodata);
        build/src/func_8011DF78.o(.rodata);
        build/src/func_8011DFCC.o(.rodata);
        build/asm/1ED00.o(.rodata);
        build/src/func_8011E1CC.o(.rodata);
        build/src/func_8011E20C.o(.rodata);
        build/src/func_8011E25C.o(.rodata);
        build/src/func_8011E2B0.o(.rodata);
        build/src/func_8011E37C.o(.rodata);
        build/src/func_8011E3BC.o(.rodata);
        build/src/func_8011E40C.o(.rodata);
        build/src/func_8011E460.o(.rodata);
        build/src/func_8011E4F0.o(.rodata);
        build/src/func_8011E528.o(.rodata);
        build/src/func_8011E574.o(.rodata);
        build/src/func_8011E5C0.o(.rodata);
        build/src/func_8011E650.o(.rodata);
        build/src/func_8011E688.o(.rodata);
        build/src/func_8011E6D4.o(.rodata);
        build/asm/1F320.o(.rodata);
        build/asm/1F960.o(.rodata);
        build/src/func_8011FCA4.o(.rodata);
        build/src/func_8011FCE8.o(.rodata);
        build/asm/2092C.o(.rodata);
        build/src/func_8011FD40.o(.rodata);
        build/asm/20974.o(.rodata);
        build/src/func_8011FDC8.o(.rodata);
        build/asm/20A08.o(.rodata);
        build/src/func_8011FFD8.o(.rodata);
        build/src/func_80120030.o(.rodata);
        build/asm/20C9C.o(.rodata);
        build/src/func_80120BAC.o(.rodata);
        build/src/func_80120BC4.o(.rodata);
        build/asm/21840.o(.rodata);
        build/src/func_801222D8.o(.rodata);
        build/src/func_80122300.o(.rodata);
        build/asm/22F74.o(.rodata);
        build/src/func_801226BC.o(.rodata);
        build/asm/2338C.o(.rodata);
        build/src/func_80122C0C.o(.rodata);
        build/asm/23828.o(.rodata);
        build/src/sound_chan_setMidi.o(.rodata);
        build/src/sound_chan_misc.o(.rodata);
        build/asm/23C74.o(.rodata);
        build/src/func_80123104.o(.rodata);
        build/asm/23D1C.o(.rodata);
        build/src/func_801239CC.o(.rodata);
        build/asm/245E0.o(.rodata);
        build/src/func_80124200.o(.rodata);
        build/asm/24E28.o(.rodata);
        build/src/func_80124F54.o(.rodata);
        build/asm/25B78.o(.rodata);
        build/src/func_80125918.o(.rodata);
        build/asm/26538.o(.rodata);
        build/src/func_80126140.o(.rodata);
        build/src/func_80126170.o(.rodata);
        build/asm/26DB8.o(.rodata);
        build/src/func_801287F0.o(.rodata);
        build/src/func_80128810.o(.rodata);
        build/src/func_80128830.o(.rodata);
        build/src/func_80128850.o(.rodata);
        build/src/func_801288C0.o(.rodata);
        build/src/func_8012891C.o(.rodata);
        build/src/func_80128930.o(.rodata);
        build/src/func_80128970.o(.rodata);
        build/asm/295C0.o(.rodata);
        build/asm/29610.o(.rodata);
        build/src/func_80129160.o(.rodata);
        build/asm/29D68.o(.rodata);
        build/src/func_80129C10.o(.rodata);
        build/asm/2A8D0.o(.rodata);
        build/asm/2A970.o(.rodata);
        build/asm/2ACC0.o(.rodata);
        build/asm/2AD70.o(.rodata);
        build/src/func_8012A390.o(.rodata);
        build/asm/2AFD0.o(.rodata);
        build/asm/2B060.o(.rodata);
        build/src/func_8012A4C0.o(.rodata);
        build/src/func_8012A500.o(.rodata);
        build/asm/2B120.o(.rodata);
        build/asm/2B1B0.o(.rodata);
        build/asm/2B240.o(.rodata);
        build/asm/2B2A0.o(.rodata);
        build/src/func_8012AB70.o(.rodata);
        build/asm/2B850.o(.rodata);
        build/src/func_8012AC9C.o(.rodata);
        build/asm/2B8C0.o(.rodata);
        build/asm/2B920.o(.rodata);
        build/src/func_8012B1E0.o(.rodata);
        build/src/func_8012B288.o(.rodata);
        build/src/func_8012B330.o(.rodata);
        build/src/func_8012B3BC.o(.rodata);
        build/asm/2C0A8.o(.rodata);
        build/asm/2C0B0.o(.rodata);
        build/src/func_8012B5D0.o(.rodata);
        build/asm/2C200.o(.rodata);
        build/src/func_8012B934.o(.rodata);
        build/asm/2C54C.o(.rodata);
        build/asm/2CE60.o(.rodata);
        build/src/func_8012C338.o(.rodata);
        build/asm/2CF70.o(.rodata);
        build/asm/2DBE0.o(.rodata);
        build/asm/2DED0.o(.rodata);
        build/src/func_8012DE50.o(.rodata);
        build/src/func_8012DE70.o(.rodata);
        build/asm/2EAB0.o(.rodata);
        build/asm/2EB10.o(.rodata);
        build/asm/2EBB0.o(.rodata);
        build/src/func_8012E03C.o(.rodata);
        build/asm/2ED28.o(.rodata);
        build/asm/2ED30.o(.rodata);
        build/src/func_8012FE34.o(.rodata);
        build/asm/30A6C.o(.rodata);
        build/asm/30C80.o(.rodata);
        build/src/func_801311F8.o(.rodata);
        build/asm/31E5C.o(.rodata);
        build/src/func_801312CC.o(.rodata);
        build/asm/31F3C.o(.rodata);
        build/src/func_801317E4.o(.rodata);
        build/asm/32440.o(.rodata);
        build/src/func_80131A54.o(.rodata);
        build/src/func_80131A90.o(.rodata);
        build/asm/326B0.o(.rodata);
        build/src/func_80131CFC.o(.rodata);
        build/asm/32960.o(.rodata);
        build/src/func_80131FC0.o(.rodata);
        build/asm/32BF8.o(.rodata);
        build/src/func_80132160.o(.rodata);
        build/asm/32D90.o(.rodata);
        build/src/func_801321F0.o(.rodata);
        build/src/func_80132240.o(.rodata);
        build/asm/32E60.o(.rodata);
        build/asm/32ED0.o(.rodata);
        build/src/func_80132400.o(.rodata);
        build/asm/33030.o(.rodata);
        build/src/func_80132440.o(.rodata);
        build/asm/33070.o(.rodata);
        build/asm/33110.o(.rodata);
        build/src/func_801325A0.o(.rodata);
        build/asm/331B0.o(.rodata);
        build/asm/33230.o(.rodata);
        build/asm/33380.o(.rodata);
        build/asm/33580.o(.rodata);
        build/src/func_80132E8C.o(.rodata);
        build/asm/33AD0.o(.rodata);
        build/src/ultra_libc_ll.o(.rodata);
        build/asm/33EA0.o(.rodata);
        build/asm/34880.o(.rodata);
        build/asm/34E30.o(.rodata);
        build/src/func_80134600.o(.rodata);
        build/asm/352C0.o(.rodata);
        build/asm/35600.o(.rodata);
        build/asm/35750.o(.rodata);
        build/src/ultra_os_virtualtophysical.o(.rodata);
        build/asm/359B0.o(.rodata);
        build/asm/35A30.o(.rodata);
        build/src/ultra_os_pirawread.o(.rodata);
        build/asm/35E50.o(.rodata);
        build/src/ultra_os_func_80135270.o(.rodata);
        build/asm/35EB0.o(.rodata);
        build/src/ultra_os_sprawdma.o(.rodata);
        build/asm/36160.o(.rodata);
        build/src/ultra_os_func_80135610.o(.rodata);
        build/src/ultra_os_func_80135660.o(.rodata);
        build/src/ultra_os_func_801356D0.o(.rodata);
        build/src/func_80135720.o(.rodata);
        build/src/ultra_os_func_80135740.o(.rodata);
        build/asm/363B0.o(.rodata);
        build/asm/36470.o(.rodata);
        build/src/func_801359E0.o(.rodata);
        build/asm/366A0.o(.rodata);
        build/src/ultra_os_func_80136020.o(.rodata);
        build/src/func_80136090.o(.rodata);
        build/src/ultra_os_func_801360A0.o(.rodata);
        build/src/func_80136124.o(.rodata);
        build/asm/36D4C.o(.rodata);
        build/src/func_80136150.o(.rodata);
        build/src/func_801361B0.o(.rodata);
        build/asm/36E10.o(.rodata);
        build/src/func_80136398.o(.rodata);
        build/asm/36FC8.o(.rodata);
        build/asm/37080.o(.rodata);
        build/asm/37290.o(.rodata);
        build/asm/37F50.o(.rodata);
        build/src/func_801374B0.o(.rodata);
        build/src/func_801374D4.o(.rodata);
        build/asm/38130.o(.rodata);
        build/asm/38180.o(.rodata);
        build/src/memcpy.o(.rodata);
        build/src/strlen.o(.rodata);
        build/src/func_801376B4.o(.rodata);
        build/src/ultra_os_createmesgqueue.o(.rodata);
        build/asm/38330.o(.rodata);
        build/asm/383B0.o(.rodata);
        build/src/ultra_os_sp_busy.o(.rodata);
        build/src/ultra_os_si_busy.o(.rodata);
        build/asm/384C0.o(.rodata);
        build/src/func_80137AF0.o(.rodata);
        build/asm/38708.o(.rodata);
        build/src/ultra_os_func_80137B10.o(.rodata);
        build/asm/38760.o(.rodata);
        build/src/ultra_os_gettime.o(.rodata);
        build/asm/38B70.o(.rodata);
        build/src/ultra_os_setglobalintmask.o(.rodata);
        build/src/ultra_io_aisetfreq.o(.rodata);
        build/asm/39104.o(.rodata);
        build/src/ultra_gu_normalize.o(.rodata);
        build/asm/391A0.o(.rodata);
        build/src/func_801385B0.o(.rodata);
        build/asm/391C0.o(.rodata);
        build/asm/39530.o(.rodata);
        build/asm/39670.o(.rodata);
        build/asm/39970.o(.rodata);
        build/src/ultra_os_func_80138DB0.o(.rodata);
        build/asm/399E0.o(.rodata);
        build/src/ultra_os_func_80138F50.o(.rodata);
        build/src/ultra_os_settime.o(.rodata);
        build/src/ultra_os_func_80138FD0.o(.rodata);
        build/asm/39C40.o(.rodata);
        build/asm/39E20.o(.rodata);
        build/src/func_801393E0.o(.rodata);
        build/asm/3A060.o(.rodata);
        build/asm/3A250.o(.rodata);
        build/asm/3ADD0.o(.rodata);
        build/asm/3B1F0.o(.rodata);
        build/src/ultra_os_func_8013B2D0.o(.rodata);
        build/asm/3BF20.o(.rodata);
        build/asm/3C080.o(.rodata);
        build/src/ultra_os_func_8013B4E0.o(.rodata);
        build/asm/3C130.o(.rodata);
        build/asm/3C380.o(.rodata);
        build/asm/3C5B0.o(.rodata);
        build/asm/3C720.o(.rodata);
        build/src/ultra_os_settimer.o(.rodata);
        build/asm/3C960.o(.rodata);
        build/asm/3D420.o(.rodata);
        build/asm/3D5B0.o(.rodata);
        build/src/ultra_os_func_8013CC50.o(.rodata);
        build/src/ultra_os_dpsetnextbuf.o(.rodata);
        build/src/ultra_os_dp_busy.o(.rodata);
        build/src/func_8013CD80.o(.rodata);
        build/src/func_8013CD90.o(.rodata);
        build/asm/3D9A0.o(.rodata);
        build/src/getters.o(.rodata);
        build/asm/3DCC0.o(.rodata);
        build/asm/3DCF0.o(.rodata);
        build/src/ultra_os_func_8013D240.o(.rodata);
        build/asm/3DE98.o(.rodata);
        build/asm/3DEA0.o(.rodata);
        build/src/ultra_libc_ll_to_d.o(.rodata);
        build/asm/3E044.o(.rodata);
        build/asm/3E0B0.o(.rodata);
        build/src/ultra_os_ai_busy.o(.rodata);
        build/src/ultra_os_func_8013D820.o(.rodata);
        build/src/ultra_os_sp_setpc.o(.rodata);
        build/asm/3E4A0.o(.rodata);
        build/asm/3E580.o(.rodata);
        build/asm/3F3A0.o(.rodata);
        build/asm/40200.o(.rodata);
        build/asm/41400.o(.rodata);
        build/asm/41960.o(.rodata);
        build/asm/43B80.o(.rodata);
        build/asm/43BA0.o(.rodata);
        build/asm/59660.o(.rodata);
        build/asm/BD510.o(.rodata);
        build/asm/BD600.o(.rodata);
        build/asm/BF590.o(.rodata);
        build/asm/BF5B0.o(.rodata);
        build/asm/C1C10.o(.rodata);
        build/asm/C5CE0.o(.rodata);
        build/asm/DD530.o(.rodata);
        build/asm/DD740.o(.rodata);
        build/asm/DD800.o(.rodata);
        build/asm/DD860.o(.rodata);
        build/asm/DD8A0.o(.rodata);
        build/asm/DD8E0.o(.rodata);
        build/asm/DD920.o(.rodata);
        build/asm/DD960.o(.rodata);
        build/asm/DDF20.o(.rodata);
        build/asm/DDF40.o(.rodata);
        build/asm/DDFE0.o(.rodata);
        build/asm/DE0C0.o(.rodata);
        build/asm/DE100.o(.rodata);
        build/asm/DE1A0.o(.rodata);
        build/asm/DE320.o(.rodata);
        build/asm/DE460.o(.rodata);
        build/asm/DE4C0.o(.rodata);
        build/asm/DE580.o(.rodata);
        build/asm/DE660.o(.rodata);
        build/asm/DE760.o(.rodata);
        build/asm/DE780.o(.rodata);
        build/asm/DE850.o(.rodata);
        build/asm/DE870.o(.rodata);
        build/asm/DEE90.o(.rodata);
        build/asm/DEEE0.o(.rodata);
        build/asm/DEF50.o(.rodata);
        build/asm/DF620.o(.rodata);
        build/asm/DFEE0.o(.rodata);
        build/asm/E3140.o(.rodata);
        build/asm/110890.o(.rodata);
        build/asm/17E5C0.o(.rodata);
        build/asm/180C00.o(.rodata);
        build/asm/193E00.o(.rodata);
        build/asm/1A9D90.o(.rodata);
        build/asm/1C1C00.o(.rodata);
        build/asm/1D6680.o(.rodata);
        build/asm/1D6FB0.o(.rodata);
        build/asm/1D9A40.o(.rodata);
        build/asm/1DC790.o(.rodata);
        build/asm/1E05A0.o(.rodata);
        build/asm/1E1260.o(.rodata);
        build/asm/1E1400.o(.rodata);
        build/asm/1E5A20.o(.rodata);
        build/asm/203C50.o(.rodata);
        build/asm/203DF0.o(.rodata);
        build/asm/22E0F0.o(.rodata);
        build/asm/25EAA0.o(.rodata);
        build/asm/261190.o(.rodata);
        build/asm/266A70.o(.rodata);
        build/asm/26C1F0.o(.rodata);
        build/asm/26D7A0.o(.rodata);
        build/asm/26D7B0.o(.rodata);
        build/asm/26FA40.o(.rodata);
        build/asm/271200.o(.rodata);
        build/asm/2725B0.o(.rodata);
        build/asm/2729C0.o(.rodata);
        build/asm/272A60.o(.rodata);
        build/asm/272B30.o(.rodata);
        build/asm/275B30.o(.rodata);
        build/asm/320C50.o(.rodata);
        build/asm/33E080.o(.rodata);
        build/asm/340C30.o(.rodata);
        build/asm/342BB0.o(.rodata);
        build/asm/3BD4C0.o(.rodata);
        build/asm/3DD410.o(.rodata);
        build/asm/3E0C30.o(.rodata);
        build/asm/3E1260.o(.rodata);
        build/asm/3E17F0.o(.rodata);
        build/asm/3F3C10.o(.rodata);
        build/asm/3F51C0.o(.rodata);
        build/asm/40E200.o(.rodata);
        build/asm/4388F0.o(.rodata);
        build/asm/460000.o(.rodata);
        build/asm/485D70.o(.rodata);
        build/asm/49F230.o(.rodata);
        build/asm/49F8A0.o(.rodata);
        build/asm/4A0010.o(.rodata);
        build/asm/4A0240.o(.rodata);
        build/asm/4A0860.o(.rodata);
        build/asm/4A5380.o(.rodata);
        build/asm/4B3050.o(.rodata);
        build/asm/4B4C00.o(.rodata);
        build/asm/4BE370.o(.rodata);
        build/asm/4CACB0.o(.rodata);
        build/asm/504C00.o(.rodata);
        build/src/func_80605644.o(.rodata);
        build/asm/50628C.o(.rodata);
        build/asm/506290.o(.rodata);
        build/asm/5064F0.o(.rodata);
        build/src/func_80605D1C.o(.rodata);
        build/asm/506930.o(.rodata);
        build/asm/506DD0.o(.rodata);
        build/asm/506FB0.o(.rodata);
        build/asm/52E460.o(.rodata);
        build/asm/536330.o(.rodata);
        build/asm/53FC30.o(.rodata);
        build/asm/5BB100.o(.rodata);
        build/asm/5CF4F0.o(.rodata);
        build/asm/5D56F0.o(.rodata);
        build/asm/62A1F0.o(.rodata);
        build/asm/6B54A0.o(.rodata);
        build/asm/6B81E0.o(.rodata);
        build/asm/714350.o(.rodata);
        build/asm/732FD0.o(.rodata);
        build/asm/734B60.o(.rodata);
        build/asm/7724A0.o(.rodata);
        build/asm/772AF0.o(.rodata);
        build/asm/773C50.o(.rodata);
        build/asm/779730.o(.rodata);
        build/asm/780880.o(.rodata);
        build/asm/780CA0.o(.rodata);
        build/asm/780D90.o(.rodata);
        build/asm/78A3F0.o(.rodata);
        build/asm/7C0CA0.o(.rodata);
        build/asm/7FC4B0.o(.rodata);
        build/asm/8003C0.o(.rodata);
        build/asm/80F2C0.o(.rodata);
        build/asm/81AB30.o(.rodata);
        build/asm/81B270.o(.rodata);
        build/asm/81B9D0.o(.rodata);
        build/asm/81C0B0.o(.rodata);
        build/asm/81C730.o(.rodata);
        build/asm/81DDA0.o(.rodata);
        build/asm/831D70.o(.rodata);
        build/asm/86FD40.o(.rodata);
        build/asm/9FF2F0.o(.rodata);
        build/asm/AA4EC0.o(.rodata);
        build/asm/AA5150.o(.rodata);
        build/asm/AC2740.o(.rodata);
        build/asm/AC70A0.o(.rodata);
        build/asm/AD0A00.o(.rodata);
        build/asm/ADDA00.o(.rodata);
        build/asm/AE1960.o(.rodata);
        build/asm/AEC350.o(.rodata);
        build/asm/AEFC00.o(.rodata);
        build/asm/AEFC10.o(.rodata);
        build/asm/B00CA0.o(.rodata);
        build/asm/BAFBE0.o(.rodata);
        . = ALIGN(., 16);
        main_RODATA_END = .;
        main_RODATA_SIZE = ABSOLUTE(main_RODATA_END - main_RODATA_START);
    }
    main_bss_VRAM = ADDR(.main_bss);
    .main_bss (NOLOAD) :
    {
        FILL(0x00000000);
        main_BSS_START = .;
        build/asm/1000.o(.bss);
        build/src/func_8010046C.o(.bss);
        build/src/boot_hw_probe.o(.bss);
        build/src/func_801004E0.o(.bss);
        build/asm/1110.o(.bss);
        build/src/func_80100920.o(.bss);
        build/asm/1528.o(.bss);
        build/src/func_801009A0.o(.bss);
        build/src/func_80100A08.o(.bss);
        build/asm/1664.o(.bss);
        build/src/func_80100C74.o(.bss);
        build/asm/1ABC.o(.bss);
        build/src/func_80101810.o(.bss);
        build/asm/2498.o(.bss);
        build/src/func_801024E4.o(.bss);
        build/asm/3110.o(.bss);
        build/src/func_80102954.o(.bss);
        build/src/func_801029BC.o(.bss);
        build/asm/3610.o(.bss);
        build/src/func_80102C20.o(.bss);
        build/asm/3894.o(.bss);
        build/src/func_8010345C.o(.bss);
        build/asm/4130.o(.bss);
        build/asm/4680.o(.bss);
        build/src/func_801047D4.o(.bss);
        build/src/func_80104838.o(.bss);
        build/asm/5510.o(.bss);
        build/src/func_801049C4.o(.bss);
        build/asm/5624.o(.bss);
        build/src/func_80104AF8.o(.bss);
        build/asm/5770.o(.bss);
        build/src/func_80104D94.o(.bss);
        build/src/func_80104DE8.o(.bss);
        build/src/func_80104E7C.o(.bss);
        build/src/func_80104EA4.o(.bss);
        build/asm/5B24.o(.bss);
        build/src/func_801053F0.o(.bss);
        build/src/func_80105418.o(.bss);
        build/asm/60D0.o(.bss);
        build/asm/637C.o(.bss);
        build/src/func_801067EC.o(.bss);
        build/src/func_80106804.o(.bss);
        build/src/func_80106878.o(.bss);
        build/asm/7508.o(.bss);
        build/src/func_80106E24.o(.bss);
        build/src/func_80106E5C.o(.bss);
        build/src/func_80106EC0.o(.bss);
        build/src/func_80106F10.o(.bss);
        build/asm/7B8C.o(.bss);
        build/src/func_80107354.o(.bss);
        build/asm/7FAC.o(.bss);
        build/src/func_801075FC.o(.bss);
        build/asm/82F0.o(.bss);
        build/src/func_80107850.o(.bss);
        build/asm/845C.o(.bss);
        build/src/func_801078C4.o(.bss);
        build/asm/8510.o(.bss);
        build/src/func_801079B8.o(.bss);
        build/src/func_80107A04.o(.bss);
        build/asm/8814.o(.bss);
        build/asm/8820.o(.bss);
        build/src/func_80107CBC.o(.bss);
        build/asm/8914.o(.bss);
        build/src/func_80107E80.o(.bss);
        build/src/func_80107EF8.o(.bss);
        build/src/func_80107F24.o(.bss);
        build/src/func_80108000.o(.bss);
        build/src/func_80108024.o(.bss);
        build/src/func_801080A0.o(.bss);
        build/asm/8D18.o(.bss);
        build/src/func_801081F0.o(.bss);
        build/src/func_8010821C.o(.bss);
        build/src/func_801082D8.o(.bss);
        build/src/func_80108360.o(.bss);
        build/asm/8F94.o(.bss);
        build/src/func_80108460.o(.bss);
        build/src/func_8010848C.o(.bss);
        build/src/func_801084F4.o(.bss);
        build/src/func_80108560.o(.bss);
        build/src/func_801086B8.o(.bss);
        build/src/func_80108724.o(.bss);
        build/src/func_80108814.o(.bss);
        build/src/func_8010888C.o(.bss);
        build/src/func_801088B8.o(.bss);
        build/src/func_80108930.o(.bss);
        build/src/func_8010898C.o(.bss);
        build/src/func_80108A04.o(.bss);
        build/asm/9828.o(.bss);
        build/src/func_80109760.o(.bss);
        build/asm/A390.o(.bss);
        build/src/func_80109918.o(.bss);
        build/src/func_80109B1C.o(.bss);
        build/asm/A77C.o(.bss);
        build/src/func_80109C94.o(.bss);
        build/asm/A90C.o(.bss);
        build/src/func_80109E20.o(.bss);
        build/asm/AA94.o(.bss);
        build/src/func_8010A410.o(.bss);
        build/src/func_8010A490.o(.bss);
        build/src/func_8010A52C.o(.bss);
        build/asm/B1F8.o(.bss);
        build/src/func_8010A740.o(.bss);
        build/src/func_8010A828.o(.bss);
        build/src/func_8010A8A4.o(.bss);
        build/src/func_8010A92C.o(.bss);
        build/src/func_8010A9D8.o(.bss);
        build/src/func_8010AA0C.o(.bss);
        build/src/func_8010AA84.o(.bss);
        build/src/func_8010AAD8.o(.bss);
        build/src/func_8010AB30.o(.bss);
        build/src/func_8010ABAC.o(.bss);
        build/src/func_8010AC28.o(.bss);
        build/src/func_8010ACAC.o(.bss);
        build/src/func_8010AD14.o(.bss);
        build/src/func_8010AD88.o(.bss);
        build/asm/B9A0.o(.bss);
        build/src/func_8010AE4C.o(.bss);
        build/asm/BAC4.o(.bss);
        build/src/func_8010B6F0.o(.bss);
        build/src/func_8010B740.o(.bss);
        build/src/func_8010B774.o(.bss);
        build/src/func_8010B808.o(.bss);
        build/src/func_8010B830.o(.bss);
        build/asm/C480.o(.bss);
        build/src/func_8010B998.o(.bss);
        build/asm/C5B0.o(.bss);
        build/src/func_8010BC2C.o(.bss);
        build/asm/C8A8.o(.bss);
        build/src/func_8010BD44.o(.bss);
        build/src/func_8010BDDC.o(.bss);
        build/src/func_8010BE5C.o(.bss);
        build/src/func_8010BEAC.o(.bss);
        build/asm/CCD8.o(.bss);
        build/src/func_8010C1CC.o(.bss);
        build/src/func_8010C220.o(.bss);
        build/asm/CE74.o(.bss);
        build/asm/D150.o(.bss);
        build/src/func_8010C5B4.o(.bss);
        build/src/func_8010C6C0.o(.bss);
        build/src/func_8010C704.o(.bss);
        build/src/func_8010C7CC.o(.bss);
        build/asm/D43C.o(.bss);
        build/src/func_8010FAFC.o(.bss);
        build/src/func_8010FB34.o(.bss);
        build/asm/107C4.o(.bss);
        build/src/func_8011054C.o(.bss);
        build/asm/11184.o(.bss);
        build/src/func_80111090.o(.bss);
        build/asm/11CBC.o(.bss);
        build/src/func_80111230.o(.bss);
        build/asm/11E68.o(.bss);
        build/src/func_80114D60.o(.bss);
        build/asm/159F0.o(.bss);
        build/src/func_80114F98.o(.bss);
        build/asm/15BF0.o(.bss);
        build/src/func_801153EC.o(.bss);
        build/asm/16048.o(.bss);
        build/src/func_80115890.o(.bss);
        build/asm/164E8.o(.bss);
        build/src/func_8011679C.o(.bss);
        build/asm/173F4.o(.bss);
        build/src/func_80116C88.o(.bss);
        build/asm/178E0.o(.bss);
        build/src/func_80117768.o(.bss);
        build/asm/183D8.o(.bss);
        build/src/func_80118CD0.o(.bss);
        build/asm/198DC.o(.bss);
        build/src/func_801191D8.o(.bss);
        build/asm/19E78.o(.bss);
        build/src/func_80119960.o(.bss);
        build/asm/1A594.o(.bss);
        build/src/func_80119CD0.o(.bss);
        build/src/func_80119D48.o(.bss);
        build/asm/1A960.o(.bss);
        build/src/func_80119DB0.o(.bss);
        build/asm/1AA78.o(.bss);
        build/asm/1AF60.o(.bss);
        build/src/vec3.o(.bss);
        build/asm/1B130.o(.bss);
        build/src/func_8011A88C.o(.bss);
        build/asm/1B4B8.o(.bss);
        build/src/func_8011AA40.o(.bss);
        build/asm/1B688.o(.bss);
        build/src/func_8011AF30.o(.bss);
        build/asm/1BB80.o(.bss);
        build/asm/1BCF0.o(.bss);
        build/src/func_8011B7FC.o(.bss);
        build/asm/1C470.o(.bss);
        build/src/func_8011BB48.o(.bss);
        build/asm/1C7C4.o(.bss);
        build/src/func_8011BFAC.o(.bss);
        build/asm/1CC24.o(.bss);
        build/src/func_8011C664.o(.bss);
        build/asm/1D2C8.o(.bss);
        build/src/func_8011C8F4.o(.bss);
        build/asm/1D54C.o(.bss);
        build/src/func_8011CB14.o(.bss);
        build/asm/1D76C.o(.bss);
        build/src/func_8011D078.o(.bss);
        build/src/func_8011D0C4.o(.bss);
        build/src/func_8011D184.o(.bss);
        build/src/func_8011D1F0.o(.bss);
        build/asm/1DE6C.o(.bss);
        build/src/func_8011D648.o(.bss);
        build/asm/1E29C.o(.bss);
        build/src/func_8011D9A4.o(.bss);
        build/asm/1E608.o(.bss);
        build/src/func_8011DF78.o(.bss);
        build/src/func_8011DFCC.o(.bss);
        build/asm/1ED00.o(.bss);
        build/src/func_8011E1CC.o(.bss);
        build/src/func_8011E20C.o(.bss);
        build/src/func_8011E25C.o(.bss);
        build/src/func_8011E2B0.o(.bss);
        build/src/func_8011E37C.o(.bss);
        build/src/func_8011E3BC.o(.bss);
        build/src/func_8011E40C.o(.bss);
        build/src/func_8011E460.o(.bss);
        build/src/func_8011E4F0.o(.bss);
        build/src/func_8011E528.o(.bss);
        build/src/func_8011E574.o(.bss);
        build/src/func_8011E5C0.o(.bss);
        build/src/func_8011E650.o(.bss);
        build/src/func_8011E688.o(.bss);
        build/src/func_8011E6D4.o(.bss);
        build/asm/1F320.o(.bss);
        build/asm/1F960.o(.bss);
        build/src/func_8011FCA4.o(.bss);
        build/src/func_8011FCE8.o(.bss);
        build/asm/2092C.o(.bss);
        build/src/func_8011FD40.o(.bss);
        build/asm/20974.o(.bss);
        build/src/func_8011FDC8.o(.bss);
        build/asm/20A08.o(.bss);
        build/src/func_8011FFD8.o(.bss);
        build/src/func_80120030.o(.bss);
        build/asm/20C9C.o(.bss);
        build/src/func_80120BAC.o(.bss);
        build/src/func_80120BC4.o(.bss);
        build/asm/21840.o(.bss);
        build/src/func_801222D8.o(.bss);
        build/src/func_80122300.o(.bss);
        build/asm/22F74.o(.bss);
        build/src/func_801226BC.o(.bss);
        build/asm/2338C.o(.bss);
        build/src/func_80122C0C.o(.bss);
        build/asm/23828.o(.bss);
        build/src/sound_chan_setMidi.o(.bss);
        build/src/sound_chan_misc.o(.bss);
        build/asm/23C74.o(.bss);
        build/src/func_80123104.o(.bss);
        build/asm/23D1C.o(.bss);
        build/src/func_801239CC.o(.bss);
        build/asm/245E0.o(.bss);
        build/src/func_80124200.o(.bss);
        build/asm/24E28.o(.bss);
        build/src/func_80124F54.o(.bss);
        build/asm/25B78.o(.bss);
        build/src/func_80125918.o(.bss);
        build/asm/26538.o(.bss);
        build/src/func_80126140.o(.bss);
        build/src/func_80126170.o(.bss);
        build/asm/26DB8.o(.bss);
        build/src/func_801287F0.o(.bss);
        build/src/func_80128810.o(.bss);
        build/src/func_80128830.o(.bss);
        build/src/func_80128850.o(.bss);
        build/src/func_801288C0.o(.bss);
        build/src/func_8012891C.o(.bss);
        build/src/func_80128930.o(.bss);
        build/src/func_80128970.o(.bss);
        build/asm/295C0.o(.bss);
        build/asm/29610.o(.bss);
        build/src/func_80129160.o(.bss);
        build/asm/29D68.o(.bss);
        build/src/func_80129C10.o(.bss);
        build/asm/2A8D0.o(.bss);
        build/asm/2A970.o(.bss);
        build/asm/2ACC0.o(.bss);
        build/asm/2AD70.o(.bss);
        build/src/func_8012A390.o(.bss);
        build/asm/2AFD0.o(.bss);
        build/asm/2B060.o(.bss);
        build/src/func_8012A4C0.o(.bss);
        build/src/func_8012A500.o(.bss);
        build/asm/2B120.o(.bss);
        build/asm/2B1B0.o(.bss);
        build/asm/2B240.o(.bss);
        build/asm/2B2A0.o(.bss);
        build/src/func_8012AB70.o(.bss);
        build/asm/2B850.o(.bss);
        build/src/func_8012AC9C.o(.bss);
        build/asm/2B8C0.o(.bss);
        build/asm/2B920.o(.bss);
        build/src/func_8012B1E0.o(.bss);
        build/src/func_8012B288.o(.bss);
        build/src/func_8012B330.o(.bss);
        build/src/func_8012B3BC.o(.bss);
        build/asm/2C0A8.o(.bss);
        build/asm/2C0B0.o(.bss);
        build/src/func_8012B5D0.o(.bss);
        build/asm/2C200.o(.bss);
        build/src/func_8012B934.o(.bss);
        build/asm/2C54C.o(.bss);
        build/asm/2CE60.o(.bss);
        build/src/func_8012C338.o(.bss);
        build/asm/2CF70.o(.bss);
        build/asm/2DBE0.o(.bss);
        build/asm/2DED0.o(.bss);
        build/src/func_8012DE50.o(.bss);
        build/src/func_8012DE70.o(.bss);
        build/asm/2EAB0.o(.bss);
        build/asm/2EB10.o(.bss);
        build/asm/2EBB0.o(.bss);
        build/src/func_8012E03C.o(.bss);
        build/asm/2ED28.o(.bss);
        build/asm/2ED30.o(.bss);
        build/src/func_8012FE34.o(.bss);
        build/asm/30A6C.o(.bss);
        build/asm/30C80.o(.bss);
        build/src/func_801311F8.o(.bss);
        build/asm/31E5C.o(.bss);
        build/src/func_801312CC.o(.bss);
        build/asm/31F3C.o(.bss);
        build/src/func_801317E4.o(.bss);
        build/asm/32440.o(.bss);
        build/src/func_80131A54.o(.bss);
        build/src/func_80131A90.o(.bss);
        build/asm/326B0.o(.bss);
        build/src/func_80131CFC.o(.bss);
        build/asm/32960.o(.bss);
        build/src/func_80131FC0.o(.bss);
        build/asm/32BF8.o(.bss);
        build/src/func_80132160.o(.bss);
        build/asm/32D90.o(.bss);
        build/src/func_801321F0.o(.bss);
        build/src/func_80132240.o(.bss);
        build/asm/32E60.o(.bss);
        build/asm/32ED0.o(.bss);
        build/src/func_80132400.o(.bss);
        build/asm/33030.o(.bss);
        build/src/func_80132440.o(.bss);
        build/asm/33070.o(.bss);
        build/asm/33110.o(.bss);
        build/src/func_801325A0.o(.bss);
        build/asm/331B0.o(.bss);
        build/asm/33230.o(.bss);
        build/asm/33380.o(.bss);
        build/asm/33580.o(.bss);
        build/src/func_80132E8C.o(.bss);
        build/asm/33AD0.o(.bss);
        build/src/ultra_libc_ll.o(.bss);
        build/asm/33EA0.o(.bss);
        build/asm/34880.o(.bss);
        build/asm/34E30.o(.bss);
        build/src/func_80134600.o(.bss);
        build/asm/352C0.o(.bss);
        build/asm/35600.o(.bss);
        build/asm/35750.o(.bss);
        build/src/ultra_os_virtualtophysical.o(.bss);
        build/asm/359B0.o(.bss);
        build/asm/35A30.o(.bss);
        build/src/ultra_os_pirawread.o(.bss);
        build/asm/35E50.o(.bss);
        build/src/ultra_os_func_80135270.o(.bss);
        build/asm/35EB0.o(.bss);
        build/src/ultra_os_sprawdma.o(.bss);
        build/asm/36160.o(.bss);
        build/src/ultra_os_func_80135610.o(.bss);
        build/src/ultra_os_func_80135660.o(.bss);
        build/src/ultra_os_func_801356D0.o(.bss);
        build/src/func_80135720.o(.bss);
        build/src/ultra_os_func_80135740.o(.bss);
        build/asm/363B0.o(.bss);
        build/asm/36470.o(.bss);
        build/src/func_801359E0.o(.bss);
        build/asm/366A0.o(.bss);
        build/src/ultra_os_func_80136020.o(.bss);
        build/src/func_80136090.o(.bss);
        build/src/ultra_os_func_801360A0.o(.bss);
        build/src/func_80136124.o(.bss);
        build/asm/36D4C.o(.bss);
        build/src/func_80136150.o(.bss);
        build/src/func_801361B0.o(.bss);
        build/asm/36E10.o(.bss);
        build/src/func_80136398.o(.bss);
        build/asm/36FC8.o(.bss);
        build/asm/37080.o(.bss);
        build/asm/37290.o(.bss);
        build/asm/37F50.o(.bss);
        build/src/func_801374B0.o(.bss);
        build/src/func_801374D4.o(.bss);
        build/asm/38130.o(.bss);
        build/asm/38180.o(.bss);
        build/src/memcpy.o(.bss);
        build/src/strlen.o(.bss);
        build/src/func_801376B4.o(.bss);
        build/src/ultra_os_createmesgqueue.o(.bss);
        build/asm/38330.o(.bss);
        build/asm/383B0.o(.bss);
        build/src/ultra_os_sp_busy.o(.bss);
        build/src/ultra_os_si_busy.o(.bss);
        build/asm/384C0.o(.bss);
        build/src/func_80137AF0.o(.bss);
        build/asm/38708.o(.bss);
        build/src/ultra_os_func_80137B10.o(.bss);
        build/asm/38760.o(.bss);
        build/src/ultra_os_gettime.o(.bss);
        build/asm/38B70.o(.bss);
        build/src/ultra_os_setglobalintmask.o(.bss);
        build/src/ultra_io_aisetfreq.o(.bss);
        build/asm/39104.o(.bss);
        build/src/ultra_gu_normalize.o(.bss);
        build/asm/391A0.o(.bss);
        build/src/func_801385B0.o(.bss);
        build/asm/391C0.o(.bss);
        build/asm/39530.o(.bss);
        build/asm/39670.o(.bss);
        build/asm/39970.o(.bss);
        build/src/ultra_os_func_80138DB0.o(.bss);
        build/asm/399E0.o(.bss);
        build/src/ultra_os_func_80138F50.o(.bss);
        build/src/ultra_os_settime.o(.bss);
        build/src/ultra_os_func_80138FD0.o(.bss);
        build/asm/39C40.o(.bss);
        build/asm/39E20.o(.bss);
        build/src/func_801393E0.o(.bss);
        build/asm/3A060.o(.bss);
        build/asm/3A250.o(.bss);
        build/asm/3ADD0.o(.bss);
        build/asm/3B1F0.o(.bss);
        build/src/ultra_os_func_8013B2D0.o(.bss);
        build/asm/3BF20.o(.bss);
        build/asm/3C080.o(.bss);
        build/src/ultra_os_func_8013B4E0.o(.bss);
        build/asm/3C130.o(.bss);
        build/asm/3C380.o(.bss);
        build/asm/3C5B0.o(.bss);
        build/asm/3C720.o(.bss);
        build/src/ultra_os_settimer.o(.bss);
        build/asm/3C960.o(.bss);
        build/asm/3D420.o(.bss);
        build/asm/3D5B0.o(.bss);
        build/src/ultra_os_func_8013CC50.o(.bss);
        build/src/ultra_os_dpsetnextbuf.o(.bss);
        build/src/ultra_os_dp_busy.o(.bss);
        build/src/func_8013CD80.o(.bss);
        build/src/func_8013CD90.o(.bss);
        build/asm/3D9A0.o(.bss);
        build/src/getters.o(.bss);
        build/asm/3DCC0.o(.bss);
        build/asm/3DCF0.o(.bss);
        build/src/ultra_os_func_8013D240.o(.bss);
        build/asm/3DE98.o(.bss);
        build/asm/3DEA0.o(.bss);
        build/src/ultra_libc_ll_to_d.o(.bss);
        build/asm/3E044.o(.bss);
        build/asm/3E0B0.o(.bss);
        build/src/ultra_os_ai_busy.o(.bss);
        build/src/ultra_os_func_8013D820.o(.bss);
        build/src/ultra_os_sp_setpc.o(.bss);
        build/asm/3E4A0.o(.bss);
        build/asm/3E580.o(.bss);
        build/asm/3F3A0.o(.bss);
        build/asm/40200.o(.bss);
        build/asm/41400.o(.bss);
        build/asm/41960.o(.bss);
        build/asm/43B80.o(.bss);
        build/asm/43BA0.o(.bss);
        build/asm/59660.o(.bss);
        build/asm/BD510.o(.bss);
        build/asm/BD600.o(.bss);
        build/asm/BF590.o(.bss);
        build/asm/BF5B0.o(.bss);
        build/asm/C1C10.o(.bss);
        build/asm/C5CE0.o(.bss);
        build/asm/DD530.o(.bss);
        build/asm/DD740.o(.bss);
        build/asm/DD800.o(.bss);
        build/asm/DD860.o(.bss);
        build/asm/DD8A0.o(.bss);
        build/asm/DD8E0.o(.bss);
        build/asm/DD920.o(.bss);
        build/asm/DD960.o(.bss);
        build/asm/DDF20.o(.bss);
        build/asm/DDF40.o(.bss);
        build/asm/DDFE0.o(.bss);
        build/asm/DE0C0.o(.bss);
        build/asm/DE100.o(.bss);
        build/asm/DE1A0.o(.bss);
        build/asm/DE320.o(.bss);
        build/asm/DE460.o(.bss);
        build/asm/DE4C0.o(.bss);
        build/asm/DE580.o(.bss);
        build/asm/DE660.o(.bss);
        build/asm/DE760.o(.bss);
        build/asm/DE780.o(.bss);
        build/asm/DE850.o(.bss);
        build/asm/DE870.o(.bss);
        build/asm/DEE90.o(.bss);
        build/asm/DEEE0.o(.bss);
        build/asm/DEF50.o(.bss);
        build/asm/DF620.o(.bss);
        build/asm/DFEE0.o(.bss);
        build/asm/E3140.o(.bss);
        build/asm/110890.o(.bss);
        build/asm/17E5C0.o(.bss);
        build/asm/180C00.o(.bss);
        build/asm/193E00.o(.bss);
        build/asm/1A9D90.o(.bss);
        build/asm/1C1C00.o(.bss);
        build/asm/1D6680.o(.bss);
        build/asm/1D6FB0.o(.bss);
        build/asm/1D9A40.o(.bss);
        build/asm/1DC790.o(.bss);
        build/asm/1E05A0.o(.bss);
        build/asm/1E1260.o(.bss);
        build/asm/1E1400.o(.bss);
        build/asm/1E5A20.o(.bss);
        build/asm/203C50.o(.bss);
        build/asm/203DF0.o(.bss);
        build/asm/22E0F0.o(.bss);
        build/asm/25EAA0.o(.bss);
        build/asm/261190.o(.bss);
        build/asm/266A70.o(.bss);
        build/asm/26C1F0.o(.bss);
        build/asm/26D7A0.o(.bss);
        build/asm/26D7B0.o(.bss);
        build/asm/26FA40.o(.bss);
        build/asm/271200.o(.bss);
        build/asm/2725B0.o(.bss);
        build/asm/2729C0.o(.bss);
        build/asm/272A60.o(.bss);
        build/asm/272B30.o(.bss);
        build/asm/275B30.o(.bss);
        build/asm/320C50.o(.bss);
        build/asm/33E080.o(.bss);
        build/asm/340C30.o(.bss);
        build/asm/342BB0.o(.bss);
        build/asm/3BD4C0.o(.bss);
        build/asm/3DD410.o(.bss);
        build/asm/3E0C30.o(.bss);
        build/asm/3E1260.o(.bss);
        build/asm/3E17F0.o(.bss);
        build/asm/3F3C10.o(.bss);
        build/asm/3F51C0.o(.bss);
        build/asm/40E200.o(.bss);
        build/asm/4388F0.o(.bss);
        build/asm/460000.o(.bss);
        build/asm/485D70.o(.bss);
        build/asm/49F230.o(.bss);
        build/asm/49F8A0.o(.bss);
        build/asm/4A0010.o(.bss);
        build/asm/4A0240.o(.bss);
        build/asm/4A0860.o(.bss);
        build/asm/4A5380.o(.bss);
        build/asm/4B3050.o(.bss);
        build/asm/4B4C00.o(.bss);
        build/asm/4BE370.o(.bss);
        build/asm/4CACB0.o(.bss);
        build/asm/504C00.o(.bss);
        build/src/func_80605644.o(.bss);
        build/asm/50628C.o(.bss);
        build/asm/506290.o(.bss);
        build/asm/5064F0.o(.bss);
        build/src/func_80605D1C.o(.bss);
        build/asm/506930.o(.bss);
        build/asm/506DD0.o(.bss);
        build/asm/506FB0.o(.bss);
        build/asm/52E460.o(.bss);
        build/asm/536330.o(.bss);
        build/asm/53FC30.o(.bss);
        build/asm/5BB100.o(.bss);
        build/asm/5CF4F0.o(.bss);
        build/asm/5D56F0.o(.bss);
        build/asm/62A1F0.o(.bss);
        build/asm/6B54A0.o(.bss);
        build/asm/6B81E0.o(.bss);
        build/asm/714350.o(.bss);
        build/asm/732FD0.o(.bss);
        build/asm/734B60.o(.bss);
        build/asm/7724A0.o(.bss);
        build/asm/772AF0.o(.bss);
        build/asm/773C50.o(.bss);
        build/asm/779730.o(.bss);
        build/asm/780880.o(.bss);
        build/asm/780CA0.o(.bss);
        build/asm/780D90.o(.bss);
        build/asm/78A3F0.o(.bss);
        build/asm/7C0CA0.o(.bss);
        build/asm/7FC4B0.o(.bss);
        build/asm/8003C0.o(.bss);
        build/asm/80F2C0.o(.bss);
        build/asm/81AB30.o(.bss);
        build/asm/81B270.o(.bss);
        build/asm/81B9D0.o(.bss);
        build/asm/81C0B0.o(.bss);
        build/asm/81C730.o(.bss);
        build/asm/81DDA0.o(.bss);
        build/asm/831D70.o(.bss);
        build/asm/86FD40.o(.bss);
        build/asm/9FF2F0.o(.bss);
        build/asm/AA4EC0.o(.bss);
        build/asm/AA5150.o(.bss);
        build/asm/AC2740.o(.bss);
        build/asm/AC70A0.o(.bss);
        build/asm/AD0A00.o(.bss);
        build/asm/ADDA00.o(.bss);
        build/asm/AE1960.o(.bss);
        build/asm/AEC350.o(.bss);
        build/asm/AEFC00.o(.bss);
        build/asm/AEFC10.o(.bss);
        build/asm/B00CA0.o(.bss);
        build/asm/BAFBE0.o(.bss);
        . = ALIGN(., 16);
        main_BSS_END = .;
        main_BSS_SIZE = ABSOLUTE(main_BSS_END - main_BSS_START);
    }
    __romPos += SIZEOF(.main);
    __romPos = ALIGN(__romPos, 16);
    . = ALIGN(., 16);
    main_ROM_END = __romPos;
    main_VRAM_END = .;

    /DISCARD/ :
    {
        *(*);
    }
}
